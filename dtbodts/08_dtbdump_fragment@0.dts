/dts-v1/;

/ {

	__fixups__ {
		accdet = "/fragment@23:target:0";
		adc = "/fragment@4/__overlay__/chg:io-channels:0", "/fragment@4/__overlay__/chg:io-channels:8", "/fragment@4/__overlay__/chg:io-channels:16", "/fragment@4/__overlay__/chg:io-channels:24", "/fragment@4/__overlay__/chg:io-channels:32", "/fragment@4/__overlay__/chg:io-channels:40", "/fragment@4/__overlay__/chg:io-channels:48", "/fragment@4/__overlay__/chg:io-channels:56";
		apuart0 = "/fragment@10:target:0";
		auxadc = "/fragment@7/__overlay__:io-channels:0", "/fragment@7/__overlay__:io-channels:8", "/fragment@7/__overlay__:io-channels:16", "/fragment@8/__overlay__:io-channels:0", "/fragment@46:target:0", "/fragment@47/__overlay__:io-channels:0";
		bat_gm30 = "/fragment@8:target:0";
		charger = "/fragment@7:target:0";
		chosen = "/fragment@0:target:0";
		disp_leds = "/fragment@24:target:0";
		dispsys_config = "/fragment@17:target:0";
		dsi0 = "/fragment@22:target:0";
		dsi_te = "/fragment@65:target:0";
		fpc_interrupt = "/fragment@33:target:0";
		goodix_fp = "/fragment@37:target:0";
		gpio = "/fragment@60:target:0";
		gpio_usage_mapping = "/fragment@59:target:0";
		gps = "/fragment@30:target:0";
		i2c0 = "/fragment@49:target:0";
		i2c1 = "/fragment@50:target:0";
		i2c2 = "/fragment@43:target:0", "/fragment@51:target:0";
		i2c3 = "/fragment@52:target:0";
		i2c4 = "/fragment@44:target:0", "/fragment@45:target:0", "/fragment@53:target:0";
		i2c5 = "/fragment@54:target:0";
		i2c6 = "/fragment@21:target:0", "/fragment@55:target:0";
		i2c7 = "/fragment@56:target:0";
		i2c8 = "/fragment@57:target:0";
		i2c9 = "/fragment@58:target:0";
		kd_camera_hw1 = "/fragment@42:target:0", "/fragment@70:target:0";
		keypad = "/fragment@26:target:0", "/fragment@72:target:0";
		lk_charger = "/fragment@6:target:0";
		md1_sim1_hot_plug_eint = "/fragment@66:target:0";
		md1_sim2_hot_plug_eint = "/fragment@67:target:0";
		md_auxadc = "/fragment@47:target:0";
		mrdump_ext_rst = "/fragment@61:target:0";
		mt6360_pmic = "/fragment@2:target:0";
		mt6360_pmu = "/fragment@1:target:0", "/fragment@4:target:0", "/fragment@4/__overlay__/chg:interrupt-parent:0";
		mt6360_typec = "/fragment@3:target:0";
		mt_pmic_vcamio_ldo_reg = "/fragment@42/__overlay__:cam0_vcamio-supply:0", "/fragment@42/__overlay__:cam1_vcamio-supply:0", "/fragment@42/__overlay__:cam2_vcamio-supply:0", "/fragment@42/__overlay__:cam3_vcamio-supply:0", "/fragment@68:target:0";
		mt_pmic_vcn13_ldo_reg = "/fragment@42/__overlay__:cam0_vcamd-supply:0", "/fragment@42/__overlay__:cam1_vcamd-supply:0";
		mt_pmic_vfp_ldo_reg = "/fragment@39/__overlay__/fingerprint@0:dvdd-supply:0";
		mt_pmic_vtp_ldo_reg = "/fragment@42/__overlay__:vcammainaf-supply:0", "/fragment@69:target:0", "/fragment@71/__overlay__:vtouch-supply:0";
		mtkfb = "/fragment@16:target:0";
		odm = "/fragment@25:target:0";
		oplus_fp_common = "/fragment@31:target:0";
		phy_tuning = "/fragment@5:target:0";
		pio = "/fragment@1/__overlay__:mt6360,intr_gpio:0", "/fragment@3/__overlay__:mt6360pd,intr_gpio:0", "/fragment@7/__overlay__:qcom,dischg-gpio:0", "/fragment@9:target:0", "/fragment@11:target:0", "/fragment@12:target:0", "/fragment@13/__overlay__/touchscreen@0:interrupt-parent:0", "/fragment@13/__overlay__/touchscreen@0:irq-gpio:0", "/fragment@13/__overlay__/touchscreen@0:reset-gpio:0", "/fragment@14:target:0", "/fragment@15:target:0", "/fragment@18:target:0", "/fragment@19/__overlay__:si,sia81xx_reset:0", "/fragment@19/__overlay__:si,sia81xx_owi:0", "/fragment@22/__overlay__/panel5@0:pm-enable-gpios:0", "/fragment@22/__overlay__/panel5@0:reset-gpios:0", "/fragment@22/__overlay__/panel5@0:bias-gpios:0", "/fragment@22/__overlay__/panel5@0:bias-gpios:12", "/fragment@22/__overlay__/panel6@0:pm-enable-gpios:0", "/fragment@22/__overlay__/panel6@0:reset-gpios:0", "/fragment@22/__overlay__/panel6@0:bias-gpios:0", "/fragment@22/__overlay__/panel6@0:bias-gpios:12", "/fragment@22/__overlay__/panel7@0:pm-enable-gpios:0", "/fragment@22/__overlay__/panel7@0:reset-gpios:0", "/fragment@22/__overlay__/panel7@0:bias-gpios:0", "/fragment@22/__overlay__/panel7@0:bias-gpios:12", "/fragment@22/__overlay__/panel8@0:pm-enable-gpios:0", "/fragment@22/__overlay__/panel8@0:reset-gpios:0", "/fragment@22/__overlay__/panel8@0:bias-gpios:0", "/fragment@22/__overlay__/panel8@0:bias-gpios:12", "/fragment@25/__overlay__/oplus_devinfo/main-sub:aboard-gpio0:0", "/fragment@25/__overlay__/kpd_volume_up:interrupt-parent:0", "/fragment@25/__overlay__/kpd_volume_down:interrupt-parent:0", "/fragment@26/__overlay__:keypad,volume-up:0", "/fragment@26/__overlay__:keypad,volume-down:0", "/fragment@27:target:0", "/fragment@28:target:0", "/fragment@29:target:0", "/fragment@31/__overlay__:oplus,fp_gpio_0:0", "/fragment@32:target:0", "/fragment@33/__overlay__:fpc,irq-gpio:0", "/fragment@33/__overlay__:fpc,reset-gpio:0", "/fragment@33/__overlay__:fpc,vdd-en:0", "/fragment@33/__overlay__:fpc,gpio_cs:0", "/fragment@33/__overlay__:pw_en_gpio:0", "/fragment@34:target:0", "/fragment@35/__overlay__:sil,silead_irq:0", "/fragment@36:target:0", "/fragment@37/__overlay__:goodix,gpio_irq:0", "/fragment@37/__overlay__:goodix,gpio_reset:0", "/fragment@37/__overlay__:goodix,gpio_cs:0", "/fragment@38:target:0", "/fragment@41:target:0", "/fragment@59/__overlay__:GPIO_SIM1_HOT_PLUG:0", "/fragment@59/__overlay__:GPIO_SIM2_HOT_PLUG:0", "/fragment@59/__overlay__:GPIO_SIM2_SCLK:0", "/fragment@59/__overlay__:GPIO_SIM2_SRST:0", "/fragment@59/__overlay__:GPIO_SIM2_SIO:0", "/fragment@59/__overlay__:GPIO_SIM1_SIO:0", "/fragment@59/__overlay__:GPIO_SIM1_SRST:0", "/fragment@59/__overlay__:GPIO_SIM1_SCLK:0", "/fragment@59/__overlay__:GPIO_FDD_BAND_SUPPORT_DETECT_1ST_PIN:0", "/fragment@59/__overlay__:GPIO_FDD_BAND_SUPPORT_DETECT_2ND_PIN:0", "/fragment@59/__overlay__:GPIO_FDD_BAND_SUPPORT_DETECT_3RD_PIN:0", "/fragment@59/__overlay__:GPIO_FDD_BAND_SUPPORT_DETECT_4TH_PIN:0", "/fragment@59/__overlay__:GPIO_RF_PWREN_RST_PIN:0", "/fragment@61/__overlay__:interrupt-parent:0", "/fragment@61/__overlay__:deb-gpios:0", "/fragment@62/__overlay__:interrupt-parent:0", "/fragment@62/__overlay__:deb-gpios:0", "/fragment@63/__overlay__:interrupt-parent:0", "/fragment@64/__overlay__:interrupt-parent:0", "/fragment@65/__overlay__:interrupt-parent:0";
		pmic_clock_buffer_ctrl = "/fragment@48:target:0";
		sia81xx_L = "/fragment@19:target:0", "/fragment@20/__overlay__:si,sia81xx-aux-devs:0", "/fragment@21/__overlay__/sia81xx_i2c@L:si,sia81xx-dev:0";
		silead_fp = "/fragment@35:target:0";
		sound = "/fragment@20:target:0";
		spi4 = "/fragment@13:target:0";
		spi5 = "/fragment@39:target:0";
		subpmic_pmu_eint = "/fragment@63:target:0";
		swtp = "/fragment@40:target:0", "/fragment@62:target:0";
		touch = "/fragment@64:target:0", "/fragment@71:target:0";
	};

	__local_fixups__ {

		fragment@10 {

			__overlay__ {
				pinctrl-0 = <0x0>;
				pinctrl-1 = <0x0>;
			};
		};

		fragment@13 {

			__overlay__ {

				touchscreen@0 {
					pinctrl-0 = <0x0>;
					pinctrl-1 = <0x0 0x4 0x8>;
					pinctrl-2 = <0x0 0x4 0x8>;
				};
			};
		};

		fragment@16 {

			__overlay__ {
				pinctrl-0 = <0x0>;
				pinctrl-1 = <0x0>;
				pinctrl-2 = <0x0>;
				pinctrl-3 = <0x0>;
				pinctrl-4 = <0x0>;
				pinctrl-5 = <0x0>;
				pinctrl-6 = <0x0>;
			};
		};

		fragment@17 {

			__overlay__ {
				pinctrl-0 = <0x0>;
				pinctrl-1 = <0x0>;
				pinctrl-2 = <0x0>;
			};
		};

		fragment@19 {

			__overlay__ {
				pinctrl-0 = <0x0>;
			};
		};

		fragment@22 {

			__overlay__ {

				panel5@0 {

					port {

						endpoint {
							remote-endpoint = <0x0>;
						};
					};
				};

				panel6@0 {

					port {

						endpoint {
							remote-endpoint = <0x0>;
						};
					};
				};

				panel7@0 {

					port {

						endpoint {
							remote-endpoint = <0x0>;
						};
					};
				};

				panel8@0 {

					port {

						endpoint {
							remote-endpoint = <0x0>;
						};
					};
				};

				ports {

					port {

						endpoint {
							remote-endpoint = <0x0>;
						};
					};
				};
			};
		};

		fragment@25 {

			__overlay__ {

				oplus_devinfo {
					pinctrl-0 = <0x0>;
					pinctrl-1 = <0x0>;
					pinctrl-2 = <0x0>;
					pinctrl-3 = <0x0>;
				};
			};
		};

		fragment@26 {

			__overlay__ {
				pinctrl-0 = <0x0>;
				pinctrl-1 = <0x0>;
			};
		};

		fragment@30 {

			__overlay__ {
				pinctrl-0 = <0x0>;
				pinctrl-1 = <0x0>;
				pinctrl-2 = <0x0>;
				pinctrl-3 = <0x0>;
				pinctrl-4 = <0x0>;
				pinctrl-5 = <0x0>;
				pinctrl-6 = <0x0>;
			};
		};

		fragment@31 {

			__overlay__ {
				pinctrl-0 = <0x0>;
				pinctrl-1 = <0x0>;
			};
		};

		fragment@33 {

			__overlay__ {
				pinctrl-0 = <0x0 0x4 0x8>;
				pinctrl-1 = <0x0>;
			};
		};

		fragment@35 {

			__overlay__ {
				pinctrl-0 = <0x0>;
				pinctrl-1 = <0x0>;
				pinctrl-2 = <0x0>;
				pinctrl-3 = <0x0>;
				pinctrl-4 = <0x0>;
			};
		};

		fragment@37 {

			__overlay__ {
				pinctrl-0 = <0x0 0x4>;
				pinctrl-1 = <0x0 0x4 0x8 0xc>;
				pinctrl-2 = <0x0>;
			};
		};

		fragment@42 {

			__overlay__ {
				pinctrl-0 = <0x0>;
				pinctrl-1 = <0x0>;
				pinctrl-10 = <0x0>;
				pinctrl-11 = <0x0>;
				pinctrl-12 = <0x0>;
				pinctrl-13 = <0x0>;
				pinctrl-14 = <0x0>;
				pinctrl-15 = <0x0>;
				pinctrl-16 = <0x0>;
				pinctrl-17 = <0x0>;
				pinctrl-18 = <0x0>;
				pinctrl-19 = <0x0>;
				pinctrl-2 = <0x0>;
				pinctrl-20 = <0x0>;
				pinctrl-21 = <0x0>;
				pinctrl-22 = <0x0>;
				pinctrl-23 = <0x0>;
				pinctrl-24 = <0x0>;
				pinctrl-25 = <0x0>;
				pinctrl-26 = <0x0>;
				pinctrl-27 = <0x0>;
				pinctrl-28 = <0x0>;
				pinctrl-29 = <0x0>;
				pinctrl-3 = <0x0>;
				pinctrl-30 = <0x0>;
				pinctrl-31 = <0x0>;
				pinctrl-32 = <0x0>;
				pinctrl-33 = <0x0>;
				pinctrl-34 = <0x0>;
				pinctrl-35 = <0x0>;
				pinctrl-36 = <0x0>;
				pinctrl-4 = <0x0>;
				pinctrl-5 = <0x0>;
				pinctrl-6 = <0x0>;
				pinctrl-7 = <0x0>;
				pinctrl-8 = <0x0>;
				pinctrl-9 = <0x0>;
			};
		};

		fragment@7 {

			__overlay__ {
				pinctrl-0 = <0x0>;
				pinctrl-1 = <0x0>;
				pinctrl-2 = <0x0>;
			};
		};
	};

	__symbols__ {
		aboard_pin_gpio0_active = "/fragment@28/__overlay__/active@id0";
		aboard_pin_gpio0_idle = "/fragment@28/__overlay__/idle@id0";
		aboard_pin_gpio0_sleep = "/fragment@28/__overlay__/sleep@id0";
		als_radio_lcd = "/fragment@25/__overlay__/als_radio_lcd";
		alsps_arch = "/fragment@25/__overlay__/alsps_arch";
		cali_arch = "/fragment@25/__overlay__/cali_arch";
		camera_main_af_mtk = "/fragment@51/__overlay__/camera_main_af@18";
		camera_main_mtk = "/fragment@51/__overlay__/camera_main@6c";
		camera_main_three_mtk = "/fragment@58/__overlay__/camera_main_three@10";
		camera_main_two_mtk = "/fragment@57/__overlay__/camera_main_two@6e";
		camera_pins_cam0_mclk_2ma = "/fragment@41/__overlay__/camera_pins_cam0_mclk_2ma";
		camera_pins_cam0_mclk_4ma = "/fragment@41/__overlay__/camera_pins_cam0_mclk_4ma";
		camera_pins_cam0_mclk_6ma = "/fragment@41/__overlay__/camera_pins_cam0_mclk_6ma";
		camera_pins_cam0_mclk_8ma = "/fragment@41/__overlay__/camera_pins_cam0_mclk_8ma";
		camera_pins_cam0_mclk_off = "/fragment@41/__overlay__/camera_pins_cam0_mclk_off";
		camera_pins_cam0_rst_0 = "/fragment@41/__overlay__/cam0@0";
		camera_pins_cam0_rst_1 = "/fragment@41/__overlay__/cam0@1";
		camera_pins_cam0_vcama_0 = "/fragment@41/__overlay__/cam0@vcam2";
		camera_pins_cam0_vcama_1 = "/fragment@41/__overlay__/cam0@vcam3";
		camera_pins_cam1_mclk_2ma = "/fragment@41/__overlay__/camera_pins_cam1_mclk_2ma";
		camera_pins_cam1_mclk_4ma = "/fragment@41/__overlay__/camera_pins_cam1_mclk_4ma";
		camera_pins_cam1_mclk_6ma = "/fragment@41/__overlay__/camera_pins_cam1_mclk_6ma";
		camera_pins_cam1_mclk_8ma = "/fragment@41/__overlay__/camera_pins_cam1_mclk_8ma";
		camera_pins_cam1_mclk_off = "/fragment@41/__overlay__/camera_pins_cam1_mclk_off";
		camera_pins_cam1_rst_0 = "/fragment@41/__overlay__/cam1@0";
		camera_pins_cam1_rst_1 = "/fragment@41/__overlay__/cam1@1";
		camera_pins_cam1_vcama_0 = "/fragment@41/__overlay__/cam1@vcam2";
		camera_pins_cam1_vcama_1 = "/fragment@41/__overlay__/cam1@vcam3";
		camera_pins_cam2_mclk_2ma = "/fragment@41/__overlay__/camera_pins_cam2_mclk_2ma";
		camera_pins_cam2_mclk_4ma = "/fragment@41/__overlay__/camera_pins_cam2_mclk_4ma";
		camera_pins_cam2_mclk_6ma = "/fragment@41/__overlay__/camera_pins_cam2_mclk_6ma";
		camera_pins_cam2_mclk_8ma = "/fragment@41/__overlay__/camera_pins_cam2_mclk_8ma";
		camera_pins_cam2_mclk_off = "/fragment@41/__overlay__/camera_pins_cam2_mclk_off";
		camera_pins_cam2_rst_0 = "/fragment@41/__overlay__/cam2@0";
		camera_pins_cam2_rst_1 = "/fragment@41/__overlay__/cam2@1";
		camera_pins_cam2_vcama_0 = "/fragment@41/__overlay__/cam2@vcam2";
		camera_pins_cam2_vcama_1 = "/fragment@41/__overlay__/cam2@vcam3";
		camera_pins_cam3_mclk_2ma = "/fragment@41/__overlay__/camera_pins_cam3_mclk_2ma";
		camera_pins_cam3_mclk_4ma = "/fragment@41/__overlay__/camera_pins_cam3_mclk_4ma";
		camera_pins_cam3_mclk_6ma = "/fragment@41/__overlay__/camera_pins_cam3_mclk_6ma";
		camera_pins_cam3_mclk_8ma = "/fragment@41/__overlay__/camera_pins_cam3_mclk_8ma";
		camera_pins_cam3_mclk_off = "/fragment@41/__overlay__/camera_pins_cam3_mclk_off";
		camera_pins_cam3_rst_0 = "/fragment@41/__overlay__/cam3@0";
		camera_pins_cam3_rst_1 = "/fragment@41/__overlay__/cam3@1";
		camera_pins_cam3_vcama_0 = "/fragment@41/__overlay__/cam3@vcam2";
		camera_pins_cam3_vcama_1 = "/fragment@41/__overlay__/cam3@vcam3";
		camera_pins_default = "/fragment@41/__overlay__/camdefault";
		camera_sub_mtk = "/fragment@53/__overlay__/camera_sub@34";
		camera_sub_two_mtk = "/fragment@53/__overlay__/camera_sub_two@78";
		charger_pins_default = "/fragment@9/__overlay__/eint0default";
		ctp_novatek_spi_mode = "/fragment@14/__overlay__/ctp_novatek_spi_mode";
		ctp_ts_cs_poweroff = "/fragment@14/__overlay__/ctp_ts_cs_poweroff";
		ctp_ts_cs_poweron = "/fragment@14/__overlay__/ctp_ts_cs_poweron";
		ctp_ts_int_poweroff = "/fragment@14/__overlay__/ctp_ts_int_poweroff";
		ctp_ts_int_poweron = "/fragment@14/__overlay__/ctp_ts_int_poweron";
		ctp_ts_reset_poweroff = "/fragment@14/__overlay__/ctp_ts_reset_poweroff";
		ctp_ts_reset_poweron = "/fragment@14/__overlay__/ctp_ts_reset_poweron";
		dischg_disable = "/fragment@9/__overlay__/dischg_disable";
		dischg_enable = "/fragment@9/__overlay__/dischg_enable";
		dsi_out = "/fragment@22/__overlay__/ports/port/endpoint";
		fingerprint_pins_default = "/fragment@36/__overlay__/fingerprint_pins_default";
		fpc_irq_default = "/fragment@34/__overlay__/fpc_irq_default";
		fpc_pwr_default = "/fragment@34/__overlay__/fpc_pwr_default";
		fpc_reset_default = "/fragment@34/__overlay__/fpc_reset_default";
		gpio_fpc_cs_func = "/fragment@34/__overlay__/gpio_fpc_cs_func";
		gpio_goodix_clk_6mA = "/fragment@38/__overlay__/gpio_goodix_clk_6mA";
		gpio_goodix_cs_6mA = "/fragment@38/__overlay__/gpio_goodix_cs_6mA";
		gpio_goodix_cs_func = "/fragment@38/__overlay__/gpio_goodix_cs_func";
		gpio_goodix_irq_default = "/fragment@38/__overlay__/gpio_goodix_irq_default";
		gpio_goodix_miso_6mA = "/fragment@38/__overlay__/gpio_goodix_miso_6mA";
		gpio_goodix_mosi_6mA = "/fragment@38/__overlay__/gpio_goodix_mosi_6mA";
		gpio_goodix_reset_default = "/fragment@38/__overlay__/gpio_goodix_reset_default";
		gpio_id0_down = "/fragment@32/__overlay__/gpio_id0_down";
		gpio_id0_up = "/fragment@32/__overlay__/gpio_id0_up";
		gpio_redriver_c1_high = "/fragment@12/__overlay__/c1_high";
		gpio_redriver_c1_hiz = "/fragment@12/__overlay__/c1_highz";
		gpio_redriver_c1_init = "/fragment@12/__overlay__/c1_init";
		gpio_redriver_c1_low = "/fragment@12/__overlay__/c1_low";
		gpio_redriver_c2_high = "/fragment@12/__overlay__/c2_high";
		gpio_redriver_c2_hiz = "/fragment@12/__overlay__/c2_highz";
		gpio_redriver_c2_init = "/fragment@12/__overlay__/c2_init";
		gpio_redriver_c2_low = "/fragment@12/__overlay__/c2_low";
		gpio_u3_switch_disable = "/fragment@12/__overlay__/u3_sw_dis";
		gpio_u3_switch_enable = "/fragment@12/__overlay__/u3_sw_en";
		gpio_u3_switch_sel1 = "/fragment@12/__overlay__/u3_sw_sel1";
		gpio_u3_switch_sel2 = "/fragment@12/__overlay__/u3_sw_sel2";
		gps_l1_lna_pins_dsp_ctrl = "/fragment@29/__overlay__/gps_l1_lna@1";
		gps_l1_lna_pins_oh = "/fragment@29/__overlay__/gps_l1_lna@2";
		gps_l1_lna_pins_ol = "/fragment@29/__overlay__/gps_l1_lna@0";
		gps_l5_lna_pins_dsp_ctrl = "/fragment@29/__overlay__/gps_l5_lna@1";
		gps_l5_lna_pins_oh = "/fragment@29/__overlay__/gps_l5_lna@2";
		gps_l5_lna_pins_ol = "/fragment@29/__overlay__/gps_l5_lna@0";
		gps_pins_default = "/fragment@29/__overlay__/gps_default";
		gsensor_1 = "/fragment@25/__overlay__/gsensor_1";
		gsensor_2 = "/fragment@25/__overlay__/gsensor_2";
		gsensor_3 = "/fragment@25/__overlay__/gsensor_3";
		hw_gyro = "/fragment@25/__overlay__/hw_gyro";
		hw_pins_default = "/fragment@28/__overlay__/default@hw_sub_id";
		kpd_volume_down = "/fragment@25/__overlay__/kpd_volume_down";
		kpd_volume_up = "/fragment@25/__overlay__/kpd_volume_up";
		led0 = "/fragment@25/__overlay__/led@0";
		led1 = "/fragment@25/__overlay__/led@1";
		led2 = "/fragment@25/__overlay__/led@2";
		led3 = "/fragment@25/__overlay__/led@3";
		led4 = "/fragment@25/__overlay__/led@4";
		led5 = "/fragment@25/__overlay__/led@5";
		led6 = "/fragment@25/__overlay__/led@6";
		light_1 = "/fragment@25/__overlay__/light_1";
		light_2 = "/fragment@25/__overlay__/light_2";
		lux_aod = "/fragment@25/__overlay__/lux_aod";
		msensor_1 = "/fragment@25/__overlay__/msensor_1";
		msensor_2 = "/fragment@25/__overlay__/msensor_2";
		msensor_3 = "/fragment@25/__overlay__/msensor_3";
		mtk_camera_eeprom0 = "/fragment@43/__overlay__/camera_eeprom0@50";
		mtk_camera_eeprom1 = "/fragment@44/__overlay__/camera_eeprom1@54";
		mtk_camera_eeprom3 = "/fragment@45/__overlay__/camera_eeprom3@52";
		mtkfb_pins_lcd_bias_enn0 = "/fragment@15/__overlay__/lcd_bias_enn0_gpio";
		mtkfb_pins_lcd_bias_enn1 = "/fragment@15/__overlay__/lcd_bias_enn1_gpio";
		mtkfb_pins_lcd_bias_enp0 = "/fragment@15/__overlay__/lcd_bias_enp0_gpio";
		mtkfb_pins_lcd_bias_enp1 = "/fragment@15/__overlay__/lcd_bias_enp1_gpio";
		mtkfb_pins_lcm_dsi_te = "/fragment@15/__overlay__/lcm_dsi_te";
		mtkfb_pins_lcm_rst_out0_gpio = "/fragment@15/__overlay__/lcm_rst_out0_gpio";
		mtkfb_pins_lcm_rst_out1_gpio = "/fragment@15/__overlay__/lcm_rst_out1_gpio";
		oplus_devinfo = "/fragment@25/__overlay__/oplus_devinfo";
		oplus_fp = "/fragment@39/__overlay__/fingerprint@0";
		oplus_project = "/fragment@25/__overlay__/oplus_project";
		panel_in5 = "/fragment@22/__overlay__/panel5@0/port/endpoint";
		panel_in6 = "/fragment@22/__overlay__/panel6@0/port/endpoint";
		panel_in7 = "/fragment@22/__overlay__/panel7@0/port/endpoint";
		panel_in8 = "/fragment@22/__overlay__/panel8@0/port/endpoint";
		pick_up = "/fragment@25/__overlay__/pick_up";
		proximity_1 = "/fragment@25/__overlay__/proximity_1";
		proximity_2 = "/fragment@25/__overlay__/proximity_2";
		sia81xx_gpio_L = "/fragment@18/__overlay__/sia81xx_gpio_L";
		sia81xx_i2c_L = "/fragment@21/__overlay__/sia81xx_i2c@L";
		silfp_default = "/fragment@36/__overlay__/silfp_default";
		silfp_irq = "/fragment@36/__overlay__/silfp_irq";
		silfp_rst_high = "/fragment@36/__overlay__/silfp_rst_high";
		silfp_rst_low = "/fragment@36/__overlay__/silfp_rst_low";
		subpmic_ldo_mtk = "/fragment@54/__overlay__/subpmic_ldo@64";
		subpmic_mtk = "/fragment@54/__overlay__/subpmic@34";
		subpmic_pmic_mtk = "/fragment@54/__overlay__/subpmic_pmic@1a";
		uart0_rx_gpio_input = "/fragment@11/__overlay__/uart0_rx_gpio@gpio61";
		uart0_tx_gpio_input = "/fragment@11/__overlay__/uart0_tx_gpio@gpio62";
		usb_default = "/fragment@12/__overlay__/usb_default";
		usb_type_c_mtk = "/fragment@54/__overlay__/usb_type_c@4e";
		vibrator0 = "/fragment@25/__overlay__/vibrator@0";
		volume_down_gpio_eint = "/fragment@27/__overlay__/volume_down@0";
		volume_up_gpio_eint = "/fragment@27/__overlay__/volume_up@0";
	};

	fragment@0 {
		target = <0xffffffff>;

		__overlay__ {
			atag,videolfb-fb_base_h = <0x0>;
			atag,videolfb-fb_base_l = "~`P";
			atag,videolfb-fps = <0x1770>;
			atag,videolfb-islcm_inited = <0x0>;
			atag,videolfb-islcmfound = <0x1>;
			atag,videolfb-lcmname = "nt35595_fhd_dsi_cmd_truly_nt50358_drv";
			atag,videolfb-vramSize = <0x1be0000>;
		};
	};

	fragment@1 {
		target = <0xffffffff>;

		__overlay__ {
			mt6360,intr_gpio = <0xffffffff 0xa 0x0>;
			mt6360,intr_gpio_num = <0xa>;
		};
	};

	fragment@10 {
		target = <0xffffffff>;

		__overlay__ {
			pinctrl-0 = <0x4>;
			pinctrl-1 = <0x5>;
			pinctrl-names = "uart0_rx_gpio", "uart0_tx_gpio";
			status = "okay";
		};
	};

	fragment@11 {
		target = <0xffffffff>;

		__overlay__ {

			uart0_rx_gpio@gpio61 {
				phandle = <0x4>;

				pins_cmd_dat {
					bias-disable;
					input-enable;
					pinmux = <0x3d00>;
					slew-rate = <0x0>;
				};
			};

			uart0_tx_gpio@gpio62 {
				phandle = <0x5>;

				pins_cmd_dat {
					bias-disable;
					input-enable;
					pinmux = <0x3e00>;
					slew-rate = <0x0>;
				};
			};
		};
	};

	fragment@12 {
		target = <0xffffffff>;

		__overlay__ {

			c1_high {
				phandle = <0x5f>;

				pins_cmd_dat {
					output-high;
					pinmux = <0x2900>;
					slew-rate = <0x1>;
				};
			};

			c1_highz {
				phandle = <0x5e>;

				pins_cmd_dat {
					bias-disable;
					pinmux = <0x2900>;
					slew-rate = <0x0>;
				};
			};

			c1_init {
				phandle = <0x5c>;

				pins_cmd_dat {
					output-low;
					pinmux = <0x2900>;
					slew-rate = <0x1>;
				};
			};

			c1_low {
				phandle = <0x5d>;

				pins_cmd_dat {
					output-low;
					pinmux = <0x2900>;
					slew-rate = <0x1>;
				};
			};

			c2_high {
				phandle = <0x63>;

				pins_cmd_dat {
					output-high;
					pinmux = <0x2800>;
					slew-rate = <0x1>;
				};
			};

			c2_highz {
				phandle = <0x62>;

				pins_cmd_dat {
					bias-disable;
					pinmux = <0x2800>;
					slew-rate = <0x0>;
				};
			};

			c2_init {
				phandle = <0x60>;

				pins_cmd_dat {
					output-low;
					pinmux = <0x2800>;
					slew-rate = <0x1>;
				};
			};

			c2_low {
				phandle = <0x61>;

				pins_cmd_dat {
					output-low;
					pinmux = <0x2800>;
					slew-rate = <0x1>;
				};
			};

			u3_sw_dis {
				phandle = <0x67>;
			};

			u3_sw_en {
				phandle = <0x66>;
			};

			u3_sw_sel1 {
				phandle = <0x64>;

				pins_cmd_dat {
					output-low;
					pinmux = <0xb00>;
					slew-rate = <0x1>;
				};
			};

			u3_sw_sel2 {
				phandle = <0x65>;

				pins_cmd_dat {
					output-high;
					pinmux = <0xb00>;
					slew-rate = <0x1>;
				};
			};

			usb_default {
				phandle = <0x5b>;
			};
		};
	};

	fragment@13 {
		target = <0xffffffff>;

		__overlay__ {
			status = "okay";

			touchscreen@0 {
				black_gesture_support;
				black_gesture_test_support;
				charger_pump_support;
				chip-name = "NF_NT36525B";
				chip-num = <0x1>;
				compatible = "oplus,tp_noflash";
				esd_handle_support;
				firmware_name = "0xAA006IN";
				fw_edge_limit_support;
				fw_update_app_support;
				game_switch_support;
				headset_pump_support;
				health_monitor_v2_support;
				incell_screen;
				interrupt-parent = <0xffffffff>;
				interrupts = <0xe 0x2 0xe 0x0>;
				irq-gpio = <0xffffffff 0xe 0x2002>;
				irq_need_dev_resume_ok;
				lcd_trigger_load_tp_fw_support;
				noflash_support;
				pinctrl-0 = <0x6>;
				pinctrl-1 = <0x7 0x8 0x9>;
				pinctrl-2 = <0xa 0xb 0xc>;
				pinctrl-names = "default", "pin_set_low", "pin_set_high";
				platform_support_project = <0x522d>;
				platform_support_project_commandline = "default_commandline";
				platform_support_project_dir = <0x522d>;
				pressure_report_support;
				reg = <0x0>;
				report_rate_limit = <0x3c>;
				reset-gpio = <0xffffffff 0xf 0x0>;
				smart_gesture_support;
				spi-max-frequency = <0x927c00>;
				status = "ok";
				touchpanel,button-type = <0x4>;
				touchpanel,display-coords = <0x2d0 0x640>;
				touchpanel,max-num-support = <0xa>;
				touchpanel,panel-coords = <0x2d0 0x640>;
				touchpanel,touchmajor-limit = <0x0 0x36>;
				touchpanel,tx-rx-num = <0x12 0x20>;
				tp_type = <0x7>;
			};
		};
	};

	fragment@14 {
		target = <0xffffffff>;

		__overlay__ {

			ctp_novatek_spi_mode {
				phandle = <0x6>;

				pins_cmd_dat {
					drive-strength = <0x4>;
					pinmux = <0xc02 0xd02 0x6102 0x6202>;
				};
			};

			ctp_ts_cs_poweroff {
				phandle = <0x7>;

				pins_cmd_dat {
					bias-disable;
					output-low;
					pinmux = <0x6200>;
					slew-rate = <0x1>;
				};
			};

			ctp_ts_cs_poweron {
				phandle = <0xa>;

				pins_cmd_dat {
					drive-strength = <0x4>;
					pinmux = <0x6202>;
				};
			};

			ctp_ts_int_poweroff {
				phandle = <0x8>;

				pins_cmd_dat {
					bias-disable;
					output-low;
					pinmux = <0xe00>;
					slew-rate = <0x1>;
				};
			};

			ctp_ts_int_poweron {
				phandle = <0xb>;

				pins_cmd_dat {
					bias-pull-up = <0x0>;
					input-enable;
					pinmux = <0xe00>;
					slew-rate = <0x0>;
				};
			};

			ctp_ts_reset_poweroff {
				phandle = <0x9>;

				pins_cmd_dat {
					bias-disable;
					output-low;
					pinmux = <0xf00>;
					slew-rate = <0x1>;
				};
			};

			ctp_ts_reset_poweron {
				phandle = <0xc>;

				pins_cmd_dat {
					bias-disable;
					output-high;
					pinmux = <0xf00>;
					slew-rate = <0x1>;
				};
			};
		};
	};

	fragment@15 {
		target = <0xffffffff>;

		__overlay__ {

			lcd_bias_enn0_gpio {
				phandle = <0x10>;

				pins_cmd_dat {
					output-low;
					pinmux = <0x8a00>;
					slew-rate = <0x1>;
				};
			};

			lcd_bias_enn1_gpio {
				phandle = <0xf>;

				pins_cmd_dat {
					output-high;
					pinmux = <0x8a00>;
					slew-rate = <0x1>;
				};
			};

			lcd_bias_enp0_gpio {
				phandle = <0xe>;

				pins_cmd_dat {
					output-low;
					pinmux = <0x8900>;
					slew-rate = <0x1>;
				};
			};

			lcd_bias_enp1_gpio {
				phandle = <0xd>;

				pins_cmd_dat {
					output-high;
					pinmux = <0x8900>;
					slew-rate = <0x1>;
				};
			};

			lcm_dsi_te {
				phandle = <0x13>;

				pins_cmd_dat {
					pinmux = <0x5401>;
				};
			};

			lcm_rst_out0_gpio {
				phandle = <0x12>;

				pins_cmd_dat {
					output-low;
					pinmux = <0x5600>;
					slew-rate = <0x1>;
				};
			};

			lcm_rst_out1_gpio {
				phandle = <0x11>;

				pins_cmd_dat {
					output-high;
					pinmux = <0x5600>;
					slew-rate = <0x1>;
				};
			};
		};
	};

	fragment@16 {
		target = <0xffffffff>;

		__overlay__ {
			pinctrl-0 = <0xd>;
			pinctrl-1 = <0xe>;
			pinctrl-2 = <0xf>;
			pinctrl-3 = <0x10>;
			pinctrl-4 = <0x11>;
			pinctrl-5 = <0x12>;
			pinctrl-6 = <0x13>;
			pinctrl-names = "lcd_bias_enp1_gpio", "lcd_bias_enp0_gpio", "lcd_bias_enn1_gpio", "lcd_bias_enn0_gpio", "lcm_rst_out1_gpio", "lcm_rst_out0_gpio", "mode_te_te";
			status = "okay";
		};
	};

	fragment@17 {
		target = <0xffffffff>;

		__overlay__ {
			helper-value = <0x0 0x1 0x1 0x0 0x1 0x0 0x0 0x0 0x0 0x0 0x1 0x0 0x1 0x1 0x0 0x1 0x0 0x1 0x1 0x1 0x0 0x1 0x0 0x1 0x0 0x0 0x0 0x0 0x1 0x0 0x0 0x0 0x0 0x0 0x0 0x0 0x0 0x1 0x1>;
			pinctrl-0 = <0x11>;
			pinctrl-1 = <0x12>;
			pinctrl-2 = <0x13>;
			pinctrl-names = "lcm_rst_out1_gpio", "lcm_rst_out0_gpio", "mode_te_te";
			status = "okay";
		};
	};

	fragment@18 {
		target = <0xffffffff>;

		__overlay__ {

			sia81xx_gpio_L {
				phandle = <0x14>;

				pins_cmd_dat {
					bias-disable;
					pinmux = <0x8b00>;
					slew-rate = <0x1>;
				};
			};
		};
	};

	fragment@19 {
		target = <0xffffffff>;

		__overlay__ {
			channel_num = <0x0>;
			compatible = "si,sia81xx";
			dynamic_updata_vdd_port = <0x8>;
			en_dynamic_updata_vdd = <0x0>;
			en_x_filter = <0x0>;
			owi_mode = <0x1>;
			pinctrl-0 = <0x14>;
			pinctrl-names = "sia81xx_gpio";
			si,sia81xx_disable_pin = <0x0>;
			si,sia81xx_owi = <0xffffffff 0x8b 0x0>;
			si,sia81xx_reset = <0xffffffff 0x8b 0x0>;
			si,sia81xx_type = "sia8109";
			si,sia_boost_vol_support = <0x1>;
			timer_task_hdl = <0x0>;
		};
	};

	fragment@2 {
		target = <0xffffffff>;

		__overlay__ {
			pwr_off_seq = <0x4000002>;
		};
	};

	fragment@20 {
		target = <0xffffffff>;

		__overlay__ {
			audio_extern_config = <0x2>;
			si,sia81xx-aux-devs = <0xffffffff>;
			si,sia81xx-aux-devs-prefix = "SpkrLeft";
			si,sia81xx-max-num = <0x1>;
		};
	};

	fragment@21 {
		target = <0xffffffff>;

		__overlay__ {

			sia81xx_i2c@L {
				compatible = "si,sia81xx-i2c";
				phandle = <0x68>;
				reg = <0x28>;
				si,sia81xx-dev = <0xffffffff>;
			};
		};
	};

	fragment@22 {
		target = <0xffffffff>;

		__overlay__ {
			#address-cells = <0x1>;
			#size-cells = <0x0>;
			status = "okay";

			panel5@0 {
				bias-gpios = <0xffffffff 0x89 0x0 0xffffffff 0x8a 0x0>;
				compatible = "oplus21037_innolux_nt35625b_b3_vdo";
				pinctrl-names = "default";
				pm-enable-gpios = <0xffffffff 0x29 0x0>;
				reg = <0x0>;
				reset-gpios = <0xffffffff 0x56 0x0>;

				port {

					endpoint {
						phandle = <0x16>;
						remote-endpoint = <0x15>;
					};
				};
			};

			panel6@0 {
				bias-gpios = <0xffffffff 0x89 0x0 0xffffffff 0x8a 0x0>;
				compatible = "oplus21037_hx83102d_txd_vdo";
				pinctrl-names = "default";
				pm-enable-gpios = <0xffffffff 0x29 0x0>;
				reg = <0x1>;
				reset-gpios = <0xffffffff 0x56 0x0>;

				port {

					endpoint {
						phandle = <0x69>;
						remote-endpoint = <0x15>;
					};
				};
			};

			panel7@0 {
				bias-gpios = <0xffffffff 0x89 0x0 0xffffffff 0x8a 0x0>;
				compatible = "oplus21037_ili9882n_innolux_vdo";
				pinctrl-names = "default";
				pm-enable-gpios = <0xffffffff 0x29 0x0>;
				reg = <0x2>;
				reset-gpios = <0xffffffff 0x56 0x0>;

				port {

					endpoint {
						phandle = <0x6a>;
						remote-endpoint = <0x15>;
					};
				};
			};

			panel8@0 {
				bias-gpios = <0xffffffff 0x89 0x0 0xffffffff 0x8a 0x0>;
				compatible = "oplus21037_ft8006_truly_vdo";
				pinctrl-names = "default";
				pm-enable-gpios = <0xffffffff 0x29 0x0>;
				reg = <0x3>;
				reset-gpios = <0xffffffff 0x56 0x0>;

				port {

					endpoint {
						phandle = <0x6b>;
						remote-endpoint = <0x15>;
					};
				};
			};

			ports {

				port {

					endpoint {
						phandle = <0x15>;
						remote-endpoint = <0x16>;
					};
				};
			};
		};
	};

	fragment@23 {
		target = <0xffffffff>;

		__overlay__ {
			accdet-mic-mode = <0x2>;
			accdet-mic-vol = <0x8>;
			accdet-plugout-debounce = <0x1>;
			eint_detect_mode = <0x5>;
			eint_use_ext_res = <0x0>;
			headset-four-key-threshold = <0x0 0x3a 0x79 0xc0 0x190>;
			headset-mode-setting = <0x500 0x500 0x1 0x1f0 0x1325 0x800 0x3d4 0x44 0x0 0x7 0x5 0x9 0x9 0xd 0xe>;
			headset-three-key-threshold = <0x0 0x52 0xaa 0x132>;
			headset-three-key-threshold-CDD = <0x0 0x79 0xc0 0x258>;
			moisture-external-r = <0x1e8480>;
			moisture-internal-r = <0xb798>;
			moisture-water-r = <0x2710>;
			moisture_comp_vref2 = <0x0>;
			moisture_comp_vth = <0x2>;
			moisture_detect_enable = <0x1>;
			moisture_detect_mode = <0x5>;
			moisture_use_ext_res = <0x0>;
			status = "okay";
		};
	};

	fragment@24 {
		target = <0xffffffff>;

		__overlay__ {
			compatible = "mediatek,disp-leds";

			backlight {
				default-state = "on";
				label = "lcd-backlight";
				led-bits = <0xc>;
				max-brightness = <0xfff>;
				trans-bits = <0xc>;
			};
		};
	};

	fragment@25 {
		target = <0xffffffff>;

		__overlay__ {

			als_radio_lcd {
				holitech_als_radio = <0x5a>;
				innolux_als_radio = <0xa0>;
				phandle = <0x7f>;
				status = "okay";
			};

			alsps_arch {
				new-arch-supported = <0x1>;
				phandle = <0x84>;
				status = "okay";
			};

			cali_arch {
				new-arch-supported = <0x1>;
				phandle = <0x81>;
				status = "okay";
			};

			gsensor_1 {
				direction = <0x4>;
				eint_num = <0x3>;
				i2c_addr = <0x0>;
				i2c_num = <0x2>;
				phandle = <0x76>;
				sensor_name = <0x8>;
				status = "okay";
			};

			gsensor_2 {
				direction = <0x8>;
				eint_num = <0x3>;
				i2c_addr = <0x0>;
				i2c_num = <0x2>;
				phandle = <0x77>;
				sensor_name = <0x9>;
				status = "okay";
			};

			gsensor_3 {
				direction = <0x6>;
				eint_num = <0x3>;
				i2c_addr = <0x0>;
				i2c_num = <0x2>;
				phandle = <0x78>;
				sensor_name = <0x3>;
				status = "okay";
			};

			hw_gyro {
				hw-gyro-supported = <0x0>;
				phandle = <0x85>;
				status = "okay";
			};

			kpd_volume_down {
				compatible = "mediatek, VOLUME_DOWN-eint";
				debounce = <0x7d00>;
				interrupt-parent = <0xffffffff>;
				interrupts = <0x50 0x2 0x50 0x0>;
				phandle = <0x87>;
				status = "okay";
			};

			kpd_volume_up {
				compatible = "mediatek, VOLUME_UP-eint";
				debounce = <0x7d00>;
				interrupt-parent = <0xffffffff>;
				interrupts = <0x1 0x2 0x1 0x0>;
				phandle = <0x86>;
				status = "okay";
			};

			led@0 {
				compatible = "mediatek,red";
				data = <0x1>;
				led_mode = <0x0>;
				phandle = <0x6c>;
				pwm_config = <0x0 0x0 0x0 0x0 0x0>;
			};

			led@1 {
				compatible = "mediatek,green";
				data = <0x1>;
				led_mode = <0x0>;
				phandle = <0x6d>;
				pwm_config = <0x0 0x0 0x0 0x0 0x0>;
			};

			led@2 {
				compatible = "mediatek,blue";
				data = <0x1>;
				led_mode = <0x0>;
				phandle = <0x6e>;
				pwm_config = <0x0 0x0 0x0 0x0 0x0>;
			};

			led@3 {
				compatible = "mediatek,jogball-backlight";
				data = <0x1>;
				led_mode = <0x0>;
				phandle = <0x6f>;
				pwm_config = <0x0 0x0 0x0 0x0 0x0>;
			};

			led@4 {
				compatible = "mediatek,keyboard-backlight";
				data = <0x1>;
				led_mode = <0x0>;
				phandle = <0x70>;
				pwm_config = <0x0 0x0 0x0 0x0 0x0>;
			};

			led@5 {
				compatible = "mediatek,button-backlight";
				data = <0x1>;
				led_mode = <0x0>;
				phandle = <0x71>;
				pwm_config = <0x0 0x0 0x0 0x0 0x0>;
			};

			led@6 {
				compatible = "mediatek,lcd-backlight";
				data = <0x1>;
				led_mode = <0x4>;
				phandle = <0x72>;
				pwm_config = <0x0 0x1 0x0 0x0 0x0>;
			};

			light_1 {
				als_buffer_length = <0x8>;
				als_coef_a = <0x2472>;
				als_coef_b = <0xae7e>;
				als_coef_c = <0x848>;
				als_coef_d = <0x19c8>;
				als_coef_e = <0x2328>;
				als_coef_ratio = <0x50>;
				als_ratio = <0x5a>;
				als_spectral_coefficient = <0x1>;
				als_type = <0x1>;
				coefficient_mode = <0x6>;
				device_name = "stk33502";
				direction = <0x4>;
				eint_num = <0x4>;
				i2c_addr = <0x46>;
				i2c_num = <0x0>;
				phandle = <0x7e>;
				sensor_name = <0x7>;
				status = "okay";
			};

			light_2 {
				als_buffer_length = <0xa>;
				als_type = <0x1>;
				direction = <0x4>;
				eint_num = <0xb>;
				i2c_addr = <0x41>;
				i2c_num = <0x0>;
				lux_revocer = <0x12c>;
				offset_gain = <0x122>;
				phandle = <0x80>;
				scale_gain = <0x154>;
				sensor_name = <0x8>;
				status = "okay";
			};

			lux_aod {
				phandle = <0x83>;
				status = "okay";
				use-proximity = <0x1>;
			};

			msensor_1 {
				direction = <0x1>;
				eint_num = <0x0>;
				i2c_addr = <0xc>;
				i2c_num = <0x0>;
				parameter-number = <0x12>;
				phandle = <0x79>;
				sensor_name = <0x0>;
				soft-mag-parameter = <0x270c 0x0 0x2 0x0 0x3a 0x1 0x52 0x0 0x2593 0x0 0x3c 0x0 0xbc 0x1 0x66 0x0 0x2984 0x0>;
				status = "okay";
			};

			msensor_2 {
				direction = <0x1>;
				i2c_addr = <0x30>;
				i2c_num = <0x0>;
				parameter-number = <0x12>;
				phandle = <0x7a>;
				sensor_name = <0x2>;
				soft-mag-parameter = <0x270c 0x0 0x2 0x0 0x3a 0x1 0x52 0x0 0x2593 0x0 0x3c 0x0 0xbc 0x1 0x66 0x0 0x2984 0x0>;
				status = "okay";
			};

			msensor_3 {
				direction = <0x3>;
				eint_num = <0x0>;
				i2c_addr = <0xc>;
				i2c_num = <0x0>;
				phandle = <0x7b>;
				sensor_name = <0x3>;
				soft-mag-parameter = <0x280f 0x0 0x4a 0x1 0x73 0x1 0xa3 0x1 0x24e3 0x0 0xa1 0x0 0x0 0x0 0xd7 0x1 0x2829 0x0>;
				status = "okay";
			};

			oplus_devinfo {
				compatible = "oplus-devinfo";
				phandle = <0x75>;
				pinctrl-0 = <0x17>;
				pinctrl-1 = <0x18>;
				pinctrl-2 = <0x19>;
				pinctrl-3 = <0x1a>;
				pinctrl-names = "default", "aboard_gpio0_sleep", "aboard_gpio0_active", "aboard_gpio0_idle";

				main-sub {
					aboard-gpio0 = <0xffffffff 0x5b 0x0>;
					aboard-patterns = <0x0>;
					compatible = "hw-match, main-sub";
					match-projects = <0x522d>;
					use_tristate_gpio;
				};
			};

			oplus_project {
				compatible = "oplus,oplus_project";
				phandle = <0x74>;
			};

			pick_up {
				phandle = <0x82>;
				status = "okay";
				use-proximity = <0x1>;
			};

			proximity_1 {
				anti_shake_delta = <0x50>;
				cal_offset_margin = <0xbb8>;
				cali_jitter_limit = <0x1e>;
				direction = <0x4>;
				dirty_high_step = <0x96>;
				dirty_low_step = <0x64>;
				dynamic_cali_max = <0x7d0>;
				eint_num = <0x4>;
				force_cali_limit = <0x7d0>;
				high_limit = <0x258>;
				high_step = <0x190>;
				i2c_addr = <0x46>;
				i2c_num = <0x0>;
				low_limit = <0x190>;
				low_step = <0x12c>;
				offset_max = <0xea60>;
				offset_range_max = <0xfffe>;
				offset_range_min = <0x0>;
				phandle = <0x7c>;
				ps_adjust_max = <0x258>;
				ps_adjust_min = <0x0>;
				ps_dirty_limit = <0x3ff>;
				ps_ir_limit = <0x1f4>;
				raw2offset_radio = <0x3e8>;
				sampling_count = <0x5>;
				sensor-reg = <0x1 0x33>;
				sensor_name = <0x7>;
				status = "okay";
				step_div = <0x5dc>;
				step_max = <0x190>;
				step_min = <0x64>;
			};

			proximity_2 {
				anti_shake_delta = <0x50>;
				cal_offset_margin = <0xbb8>;
				cali_jitter_limit = <0x1e>;
				direction = <0x4>;
				dirty_high_step = <0x96>;
				dirty_low_step = <0x64>;
				dynamic_cali_max = <0x7d0>;
				eint_num = <0xb>;
				force_cali_limit = <0x7d0>;
				high_limit = <0x258>;
				high_step = <0x190>;
				i2c_addr = <0x41>;
				i2c_num = <0x0>;
				low_limit = <0x190>;
				low_step = <0x12c>;
				offset_max = <0xea60>;
				offset_range_max = <0xfffe>;
				offset_range_min = <0x0>;
				phandle = <0x7d>;
				ps_adjust_max = <0x258>;
				ps_adjust_min = <0x0>;
				ps_dirty_limit = <0x3ff>;
				ps_ir_limit = <0x1f4>;
				raw2offset_radio = <0x3e8>;
				sampling_count = <0x5>;
				sensor_name = <0x8>;
				status = "okay";
				step_div = <0x5dc>;
				step_max = <0x190>;
				step_min = <0x6e>;
			};

			vibrator@0 {
				compatible = "mediatek,vibrator";
				phandle = <0x73>;
				vib_limit = <0x9>;
				vib_timer = <0x19>;
				vib_vol = <0x9>;
			};
		};
	};

	fragment@26 {
		target = <0xffffffff>;

		__overlay__ {
			keypad,volume-down = <0xffffffff 0x50 0x0>;
			keypad,volume-up = <0xffffffff 0x1 0x0>;
			pinctrl-0 = <0x1b>;
			pinctrl-1 = <0x1c>;
			pinctrl-names = "volume_up_as_int", "volume_down_as_int";
			status = "okay";
		};
	};

	fragment@27 {
		target = <0xffffffff>;

		__overlay__ {

			volume_down@0 {
				phandle = <0x1c>;

				pins_cmd_dat {
					input-enable;
					pinmux = <0x5000>;
					slew-rate = <0x0>;
				};
			};

			volume_up@0 {
				phandle = <0x1b>;

				pins_cmd_dat {
					input-enable;
					pinmux = <0x100>;
					slew-rate = <0x0>;
				};
			};
		};
	};

	fragment@28 {
		target = <0xffffffff>;

		__overlay__ {

			active@id0 {
				phandle = <0x19>;

				pins_cmd_dat {
					bias-pull-up;
					input-enable;
					pinmux = <0x5b00>;
					slew-rate = <0x0>;
				};
			};

			default@hw_sub_id {
				phandle = <0x17>;
			};

			idle@id0 {
				phandle = <0x1a>;

				pins_cmd_dat {
					bias-disable;
					input-enable;
					pinmux = <0x5b00>;
					slew-rate = <0x0>;
				};
			};

			sleep@id0 {
				phandle = <0x18>;

				pins_cmd_dat {
					bias-pull-down;
					input-enable;
					pinmux = <0x5b00>;
					slew-rate = <0x0>;
				};
			};
		};
	};

	fragment@29 {
		target = <0xffffffff>;

		__overlay__ {

			gps_default {
				phandle = <0x1d>;
			};

			gps_l1_lna@0 {
				phandle = <0x1e>;

				pins_cmd_dat {
					output-low;
					pinmux = <0x5700>;
				};
			};

			gps_l1_lna@1 {
				phandle = <0x1f>;

				pins_cmd_dat {
					pinmux = <0x5702>;
				};
			};

			gps_l1_lna@2 {
				phandle = <0x20>;

				pins_cmd_dat {
					output-high;
					pinmux = <0x5700>;
				};
			};

			gps_l5_lna@0 {
				phandle = <0x21>;

				pins_cmd_dat {
					output-low;
					pinmux = <0x5b00>;
				};
			};

			gps_l5_lna@1 {
				phandle = <0x22>;

				pins_cmd_dat {
					pinmux = <0x5b04>;
				};
			};

			gps_l5_lna@2 {
				phandle = <0x23>;

				pins_cmd_dat {
					output-high;
					pinmux = <0x5b00>;
				};
			};
		};
	};

	fragment@3 {
		target = <0xffffffff>;

		__overlay__ {
			mt-tcpc,role_def = <0x1>;
			mt6360pd,intr_gpio = <0xffffffff 0x9 0x0>;
			mt6360pd,intr_gpio_num = <0x9>;
		};
	};

	fragment@30 {
		target = <0xffffffff>;

		__overlay__ {
			pinctrl-0 = <0x1d>;
			pinctrl-1 = <0x1e>;
			pinctrl-2 = <0x1f>;
			pinctrl-3 = <0x20>;
			pinctrl-4 = <0x21>;
			pinctrl-5 = <0x22>;
			pinctrl-6 = <0x23>;
			pinctrl-names = "default", "gps_l1_lna_disable", "gps_l1_lna_dsp_ctrl", "gps_l1_lna_enable", "gps_l5_lna_disable", "gps_l5_lna_dsp_ctrl", "gps_l5_lna_enable";
			status = "okay";
		};
	};

	fragment@31 {
		target = <0xffffffff>;

		__overlay__ {
			compatible = "oplus,fp_common";
			oplus,fp_gpio_0 = <0xffffffff 0x29 0x0>;
			oplus,fp_gpio_num = <0x1>;
			oplus,one_gpio_for_three_ic = <0x1>;
			pinctrl-0 = <0x24>;
			pinctrl-1 = <0x25>;
			pinctrl-names = "gpio_id0_up", "gpio_id0_down";

			fpc_id {
				chip-name = "F_1541";
				eng-menu = "-1,-1";
				oplus,fp-id = <0x0>;
				vendor-chip = <0x11>;
			};

			goodix_3626 {
				chip-name = "G_3626";
				eng-menu = "-1,-1";
				oplus,fp-id = <0x1>;
				vendor-chip = <0x10>;
			};

			silead_side {
				chip-name = "S_gsl6157";
				eng-menu = "-1,-1";
				oplus,fp-id = <0x2>;
				vendor-chip = <0x16>;
			};
		};
	};

	fragment@32 {
		target = <0xffffffff>;

		__overlay__ {

			gpio_id0_down {
				phandle = <0x25>;

				pins_cmd_dat {
					bias-pull-down;
					input-enable;
					pinmux = <0x2900>;
					slew-rate = <0x0>;
				};
			};

			gpio_id0_up {
				phandle = <0x24>;

				pins_cmd_dat {
					bias-pull-up;
					input-enable;
					pinmux = <0x2900>;
					slew-rate = <0x0>;
				};
			};
		};
	};

	fragment@33 {
		target = <0xffffffff>;

		__overlay__ {
			fpc,gpio_cs = <0xffffffff 0x24 0x0>;
			fpc,irq-gpio = <0xffffffff 0x16 0x0>;
			fpc,reset-gpio = <0xffffffff 0x15 0x0>;
			fpc,use_gpio_power_enable = <0x1>;
			fpc,vdd-en = <0xffffffff 0x8c 0x0>;
			pinctrl-0 = <0x26 0x27 0x28>;
			pinctrl-1 = <0x29>;
			pinctrl-names = "default", "fpc_cs_func";
			pw_en_gpio = <0xffffffff 0x8c 0x0>;
			status = "okay";

			power_source_1 {
				delay-time = <0x0>;
				power-mode = <0x2>;
				power-name = "pw_en_gpio";
				poweron-level = <0x0>;
			};
		};
	};

	fragment@34 {
		target = <0xffffffff>;

		__overlay__ {

			fpc_irq_default {
				phandle = <0x27>;

				pins_cmd_dat {
					bias-pull-up = <0x0>;
					pinmux = <0x1600>;
					slew-rate = <0x0>;
				};
			};

			fpc_pwr_default {
				phandle = <0x28>;

				pins_cmd_dat {
					bias-disable;
					output-low;
					pinmux = <0x8c00>;
					slew-rate = <0x1>;
				};
			};

			fpc_reset_default {
				phandle = <0x26>;

				pins_cmd_dat {
					output-low;
					pinmux = <0x1500>;
					slew-rate = <0x1>;
				};
			};

			gpio_fpc_cs_func {
				phandle = <0x29>;

				pins_cmd_dat {
					drive-strength = <0x3>;
					pinmux = <0x2401>;
				};
			};
		};
	};

	fragment@35 {
		target = <0xffffffff>;

		__overlay__ {
			pinctrl-0 = <0x2a>;
			pinctrl-1 = <0x2b>;
			pinctrl-2 = <0x2c>;
			pinctrl-3 = <0x2d>;
			pinctrl-4 = <0x2e>;
			pinctrl-names = "default", "rst-low", "rst-high", "irq-init", "spi-default";
			sil,silead_irq = <0xffffffff 0x16 0x0>;
			status = "okay";
		};
	};

	fragment@36 {
		target = <0xffffffff>;

		__overlay__ {

			fingerprint_pins_default {
				phandle = <0x2e>;

				pins_cmd2_dat {
					bias-pull-down;
					drive-strength = <0x3>;
					pinmux = <0x2301>;
					slew-rate = <0x1>;
				};

				pins_cmd3_dat {
					bias-pull-down;
					drive-strength = <0x3>;
					pinmux = <0x2601>;
					slew-rate = <0x0>;
				};

				pins_cmd4_dat {
					bias-pull-down;
					drive-strength = <0x3>;
					pinmux = <0x2501>;
					slew-rate = <0x1>;
				};

				pins_cmd_dat {
					bias-pull-up;
					drive-strength = <0x3>;
					pinmux = <0x2401>;
					slew-rate = <0x1>;
				};
			};

			silfp_default {
				phandle = <0x2a>;
			};

			silfp_irq {
				phandle = <0x2d>;

				pins_cmd_dat {
					bias-disable;
					pinmux = <0x1600>;
					slew-rate = <0x0>;
				};
			};

			silfp_rst_high {
				phandle = <0x2c>;

				pins_cmd_dat {
					output-high;
					pinmux = <0x1500>;
					slew-rate = <0x1>;
				};
			};

			silfp_rst_low {
				phandle = <0x2b>;

				pins_cmd_dat {
					output-low;
					pinmux = <0x1500>;
					slew-rate = <0x1>;
				};
			};
		};
	};

	fragment@37 {
		target = <0xffffffff>;

		__overlay__ {
			goodix,gpio_cs = <0xffffffff 0x24 0x0>;
			goodix,gpio_irq = <0xffffffff 0x16 0x0>;
			goodix,gpio_reset = <0xffffffff 0x15 0x0>;
			pinctrl-0 = <0x2f 0x30>;
			pinctrl-1 = <0x31 0x32 0x33 0x34>;
			pinctrl-2 = <0x35>;
			pinctrl-names = "default", "gf_spi_drive_6mA", "gf_cs_func";
			status = "okay";
		};
	};

	fragment@38 {
		target = <0xffffffff>;

		__overlay__ {

			gpio_goodix_clk_6mA {
				phandle = <0x31>;

				pins_cmd_dat {
					drive-strength = <0x2>;
					pinmux = <0x2301>;
				};
			};

			gpio_goodix_cs_6mA {
				phandle = <0x34>;

				pins_cmd_dat {
					drive-strength = <0x2>;
					pinmux = <0x2401>;
				};
			};

			gpio_goodix_cs_func {
				phandle = <0x35>;

				pins_cmd_dat {
					drive-strength = <0x2>;
					pinmux = <0x2401>;
				};
			};

			gpio_goodix_irq_default {
				phandle = <0x2f>;

				pins_cmd_dat {
					bias-pull-down;
					pinmux = <0x1600>;
					slew-rate = <0x0>;
				};
			};

			gpio_goodix_miso_6mA {
				phandle = <0x33>;

				pins_cmd_dat {
					drive-strength = <0x3>;
					pinmux = <0x2601>;
				};
			};

			gpio_goodix_mosi_6mA {
				phandle = <0x32>;

				pins_cmd_dat {
					drive-strength = <0x2>;
					pinmux = <0x2501>;
				};
			};

			gpio_goodix_reset_default {
				phandle = <0x30>;

				pins_cmd_dat {
					output-low;
					pinmux = <0x1500>;
					slew-rate = <0x1>;
				};
			};
		};
	};

	fragment@39 {
		target = <0xffffffff>;

		__overlay__ {
			#address-cells = <0x1>;
			#size-cells = <0x0>;
			status = "okay";

			fingerprint@0 {
				compatible = "oplus,oplus_fp";
				dvdd-config = <0x325aa0 0x325aa0 0x249f0>;
				dvdd-supply = <0xffffffff>;
				phandle = <0x88>;
				power-num = <0x1>;
				reg = <0x0>;
				spi-id = <0x5>;
				spi-irq = <0x27>;
				spi-max-frequency = <0x7a1200>;
				spi-reg = <0xa822f8>;
				status = "okay";

				power_source_1 {
					delay-time = <0x0>;
					power-config = "dvdd-config";
					power-mode = <0x1>;
					power-name = "dvdd";
				};
			};
		};
	};

	fragment@4 {
		target = <0xffffffff>;

		__overlay__ {

			chg {
				aicc_once = <0x1>;
				aicr = <0x7a120>;
				batoc_notify = <0x0>;
				chg_name = "primary_chg";
				compatible = "mediatek,mt6360_pmu_chg";
				cv = <0x426030>;
				en_te = <0x1>;
				en_wdt = <0x1>;
				ichg = <0x1e8480>;
				ieoc = <0x249f0>;
				interrupt-names = "chg_treg_evt", "chg_mivr_evt", "pwr_rdy_evt", "chg_batsysuv_evt", "chg_vsysuv_evt", "chg_vsysov_evt", "chg_vbatov_evt", "chg_vbusov_evt", "chg_tmri", "chg_adpbadi", "chg_rvpi", "chg_aiccmeasl", "wdtmri", "pumpx_donei", "attachi", "chrdet_ext_evt", "hvdcp_det";
				interrupt-parent = <0xffffffff>;
				interrupts = <0x4 0x0 0x6 0x0 0x7 0x0 0x9 0x0 0xc 0x0 0xd 0x0 0xe 0x0 0xf 0x0 0x1b 0x0 0x1d 0x0 0x1e 0x0 0x20 0x0 0x23 0x0 0x28 0x0 0x30 0x0 0x3c 0x0 0x35 0x0>;
				io-channel-names = "USBID", "VBUSDIV5", "VSYS", "VBAT", "IBUS", "IBAT", "TEMP_JC", "TS";
				io-channels = <0xffffffff 0x0 0xffffffff 0x1 0xffffffff 0x3 0xffffffff 0x4 0xffffffff 0x5 0xffffffff 0x6 0xffffffff 0x8 0xffffffff 0xa>;
				ircmp_resistor = <0x61a8>;
				ircmp_vclamp = <0x7d00>;
				mivr = <0x432380>;
				post_aicc = <0x1>;
				safety_timer = <0x14>;
			};
		};
	};

	fragment@40 {
		target = <0xffffffff>;

		__overlay__ {
			compatible = "mediatek, swtp-eint";
		};
	};

	fragment@41 {
		target = <0xffffffff>;

		__overlay__ {

			cam0@0 {
				phandle = <0x37>;

				pins_cmd_dat {
					output-low;
					pinmux = <0x3600>;
					slew-rate = <0x1>;
				};
			};

			cam0@1 {
				phandle = <0x38>;

				pins_cmd_dat {
					output-high;
					pinmux = <0x3600>;
					slew-rate = <0x1>;
				};
			};

			cam0@vcam2 {
				phandle = <0x3f>;

				pins_cmd_dat {
					output-low;
					pinmux = <0x5e00>;
					slew-rate = <0x1>;
				};
			};

			cam0@vcam3 {
				phandle = <0x40>;

				pins_cmd_dat {
					output-high;
					pinmux = <0x5e00>;
					slew-rate = <0x1>;
				};
			};

			cam1@0 {
				phandle = <0x39>;

				pins_cmd_dat {
					output-low;
					pinmux = <0x3c00>;
					slew-rate = <0x1>;
				};
			};

			cam1@1 {
				phandle = <0x3a>;

				pins_cmd_dat {
					output-high;
					pinmux = <0x3c00>;
					slew-rate = <0x1>;
				};
			};

			cam1@vcam2 {
				phandle = <0x41>;

				pins_cmd_dat {
					output-low;
					pinmux = <0x5c00>;
					slew-rate = <0x1>;
				};
			};

			cam1@vcam3 {
				phandle = <0x42>;

				pins_cmd_dat {
					output-high;
					pinmux = <0x5c00>;
					slew-rate = <0x1>;
				};
			};

			cam2@0 {
				phandle = <0x3b>;

				pins_cmd_dat {
					output-low;
					pinmux = <0x3a00>;
					slew-rate = <0x1>;
				};
			};

			cam2@1 {
				phandle = <0x3c>;

				pins_cmd_dat {
					output-high;
					pinmux = <0x3a00>;
					slew-rate = <0x1>;
				};
			};

			cam2@vcam2 {
				phandle = <0x43>;

				pins_cmd_dat {
					output-low;
					pinmux = <0x5c00>;
					slew-rate = <0x1>;
				};
			};

			cam2@vcam3 {
				phandle = <0x44>;

				pins_cmd_dat {
					output-high;
					pinmux = <0x5c00>;
					slew-rate = <0x1>;
				};
			};

			cam3@0 {
				phandle = <0x3d>;

				pins_cmd_dat {
					output-low;
					pinmux = <0x3800>;
					slew-rate = <0x1>;
				};
			};

			cam3@1 {
				phandle = <0x3e>;

				pins_cmd_dat {
					output-high;
					pinmux = <0x3800>;
					slew-rate = <0x1>;
				};
			};

			cam3@vcam2 {
				phandle = <0x45>;

				pins_cmd_dat {
					output-low;
					pinmux = <0x5c00>;
					slew-rate = <0x1>;
				};
			};

			cam3@vcam3 {
				phandle = <0x46>;

				pins_cmd_dat {
					output-high;
					pinmux = <0x5c00>;
					slew-rate = <0x1>;
				};
			};

			camdefault {
				phandle = <0x36>;
			};

			camera_pins_cam0_mclk_2ma {
				phandle = <0x48>;

				pins_cmd_dat {
					drive-strength = <0x0>;
					pinmux = <0x3101>;
				};
			};

			camera_pins_cam0_mclk_4ma {
				phandle = <0x49>;

				pins_cmd_dat {
					drive-strength = <0x1>;
					pinmux = <0x3101>;
				};
			};

			camera_pins_cam0_mclk_6ma {
				phandle = <0x4a>;

				pins_cmd_dat {
					drive-strength = <0x2>;
					pinmux = <0x3101>;
				};
			};

			camera_pins_cam0_mclk_8ma {
				phandle = <0x4b>;

				pins_cmd_dat {
					drive-strength = <0x3>;
					pinmux = <0x3101>;
				};
			};

			camera_pins_cam0_mclk_off {
				phandle = <0x47>;

				pins_cmd_dat {
					drive-strength = <0x1>;
					pinmux = <0x3100>;
				};
			};

			camera_pins_cam1_mclk_2ma {
				phandle = <0x4d>;

				pins_cmd_dat {
					drive-strength = <0x0>;
					pinmux = <0x3401>;
				};
			};

			camera_pins_cam1_mclk_4ma {
				phandle = <0x4e>;

				pins_cmd_dat {
					drive-strength = <0x1>;
					pinmux = <0x3401>;
				};
			};

			camera_pins_cam1_mclk_6ma {
				phandle = <0x4f>;

				pins_cmd_dat {
					drive-strength = <0x2>;
					pinmux = <0x3401>;
				};
			};

			camera_pins_cam1_mclk_8ma {
				phandle = <0x50>;

				pins_cmd_dat {
					drive-strength = <0x3>;
					pinmux = <0x3401>;
				};
			};

			camera_pins_cam1_mclk_off {
				phandle = <0x4c>;

				pins_cmd_dat {
					drive-strength = <0x1>;
					pinmux = <0x3400>;
				};
			};

			camera_pins_cam2_mclk_2ma {
				phandle = <0x52>;

				pins_cmd_dat {
					drive-strength = <0x0>;
					pinmux = <0x3301>;
				};
			};

			camera_pins_cam2_mclk_4ma {
				phandle = <0x53>;

				pins_cmd_dat {
					drive-strength = <0x1>;
					pinmux = <0x3301>;
				};
			};

			camera_pins_cam2_mclk_6ma {
				phandle = <0x54>;

				pins_cmd_dat {
					drive-strength = <0x2>;
					pinmux = <0x3301>;
				};
			};

			camera_pins_cam2_mclk_8ma {
				phandle = <0x55>;

				pins_cmd_dat {
					drive-strength = <0x3>;
					pinmux = <0x3301>;
				};
			};

			camera_pins_cam2_mclk_off {
				phandle = <0x51>;

				pins_cmd_dat {
					drive-strength = <0x1>;
					pinmux = <0x3300>;
				};
			};

			camera_pins_cam3_mclk_2ma {
				phandle = <0x57>;

				pins_cmd_dat {
					drive-strength = <0x0>;
					pinmux = <0x3201>;
				};
			};

			camera_pins_cam3_mclk_4ma {
				phandle = <0x58>;

				pins_cmd_dat {
					drive-strength = <0x1>;
					pinmux = <0x3201>;
				};
			};

			camera_pins_cam3_mclk_6ma {
				phandle = <0x59>;

				pins_cmd_dat {
					drive-strength = <0x2>;
					pinmux = <0x3201>;
				};
			};

			camera_pins_cam3_mclk_8ma {
				phandle = <0x5a>;

				pins_cmd_dat {
					drive-strength = <0x3>;
					pinmux = <0x3201>;
				};
			};

			camera_pins_cam3_mclk_off {
				phandle = <0x56>;

				pins_cmd_dat {
					drive-strength = <0x1>;
					pinmux = <0x3200>;
				};
			};
		};
	};

	fragment@42 {
		target = <0xffffffff>;

		__overlay__ {
			cam0_enable_sensor = "ov13b10_mipi_raw_carr s5k3l6_mipi_raw_carr";
			cam0_vcamd-supply = <0xffffffff>;
			cam0_vcamio-supply = <0xffffffff>;
			cam1_enable_sensor = "imx355_mipi_raw_carr";
			cam1_vcamd-supply = <0xffffffff>;
			cam1_vcamio-supply = <0xffffffff>;
			cam2_enable_sensor = "gc02m1b_mipi_mono_carr";
			cam2_vcamio-supply = <0xffffffff>;
			cam3_enable_sensor = "ov02b10_mipi_raw_carr gc02m1_mipi_raw_carr";
			cam3_vcamio-supply = <0xffffffff>;
			pinctrl-0 = <0x36>;
			pinctrl-1 = <0x37>;
			pinctrl-10 = <0x40>;
			pinctrl-11 = <0x41>;
			pinctrl-12 = <0x42>;
			pinctrl-13 = <0x43>;
			pinctrl-14 = <0x44>;
			pinctrl-15 = <0x45>;
			pinctrl-16 = <0x46>;
			pinctrl-17 = <0x47>;
			pinctrl-18 = <0x48>;
			pinctrl-19 = <0x49>;
			pinctrl-2 = <0x38>;
			pinctrl-20 = <0x4a>;
			pinctrl-21 = <0x4b>;
			pinctrl-22 = <0x4c>;
			pinctrl-23 = <0x4d>;
			pinctrl-24 = <0x4e>;
			pinctrl-25 = <0x4f>;
			pinctrl-26 = <0x50>;
			pinctrl-27 = <0x51>;
			pinctrl-28 = <0x52>;
			pinctrl-29 = <0x53>;
			pinctrl-3 = <0x39>;
			pinctrl-30 = <0x54>;
			pinctrl-31 = <0x55>;
			pinctrl-32 = <0x56>;
			pinctrl-33 = <0x57>;
			pinctrl-34 = <0x58>;
			pinctrl-35 = <0x59>;
			pinctrl-36 = <0x5a>;
			pinctrl-4 = <0x3a>;
			pinctrl-5 = <0x3b>;
			pinctrl-6 = <0x3c>;
			pinctrl-7 = <0x3d>;
			pinctrl-8 = <0x3e>;
			pinctrl-9 = <0x3f>;
			pinctrl-names = "default", "cam0_rst0", "cam0_rst1", "cam1_rst0", "cam1_rst1", "cam2_rst0", "cam2_rst1", "cam3_rst0", "cam3_rst1", "cam0_ldo_vcama_0", "cam0_ldo_vcama_1", "cam1_ldo_vcama_0", "cam1_ldo_vcama_1", "cam2_ldo_vcama_0", "cam2_ldo_vcama_1", "cam3_ldo_vcama_0", "cam3_ldo_vcama_1", "cam0_mclk_off", "cam0_mclk_2mA", "cam0_mclk_4mA", "cam0_mclk_6mA", "cam0_mclk_8mA", "cam1_mclk_off", "cam1_mclk_2mA", "cam1_mclk_4mA", "cam1_mclk_6mA", "cam1_mclk_8mA", "cam2_mclk_off", "cam2_mclk_2mA", "cam2_mclk_4mA", "cam2_mclk_6mA", "cam2_mclk_8mA", "cam3_mclk_off", "cam3_mclk_2mA", "cam3_mclk_4mA", "cam3_mclk_6mA", "cam3_mclk_8mA";
			status = "okay";
			vcammainaf-supply = <0xffffffff>;
		};
	};

	fragment@43 {
		target = <0xffffffff>;

		__overlay__ {

			camera_eeprom0@50 {
				compatible = "mediatek,camera_eeprom";
				phandle = <0x89>;
				reg = <0x51>;
				status = "okay";
			};
		};
	};

	fragment@44 {
		target = <0xffffffff>;

		__overlay__ {

			camera_eeprom1@54 {
				compatible = "mediatek,camera_eeprom";
				phandle = <0x8a>;
				reg = <0x54>;
				status = "okay";
			};
		};
	};

	fragment@45 {
		target = <0xffffffff>;

		__overlay__ {

			camera_eeprom3@52 {
				compatible = "mediatek,camera_eeprom";
				phandle = <0x8b>;
				reg = <0x52>;
				status = "okay";
			};
		};
	};

	fragment@46 {
		target = <0xffffffff>;

		__overlay__ {

			adc_channel@ {
				compatible = "mediatek,adc_channel";
				mediatek,adc_fdd_rf_params_dynamic_custom_ch = <0x2>;
				mediatek,temperature0 = <0x0>;
				mediatek,temperature1 = <0x1>;
				status = "okay";
			};
		};
	};

	fragment@47 {
		target = <0xffffffff>;

		__overlay__ {
			io-channels = <0xffffffff 0x2>;
		};
	};

	fragment@48 {
		target = <0xffffffff>;

		__overlay__ {
			mediatek,clkbuf-config = <0x2 0x1 0x1 0x2 0x0 0x0 0x1>;
			mediatek,clkbuf-controls-for-desense = <0x0 0x4 0x0 0x4 0x0 0x0 0x0>;
			mediatek,clkbuf-output-impedance = <0x6 0x4 0x4 0x4 0x0 0x0 0x4>;
			mediatek,clkbuf-quantity = <0x7>;
			status = "okay";
		};
	};

	fragment@49 {
		target = <0xffffffff>;

		__overlay__ {
			#address-cells = <0x1>;
			#size-cells = <0x0>;
			clock-frequency = <0x61a80>;
			mediatek,use-open-drain;
		};
	};

	fragment@5 {
		target = <0xffffffff>;

		__overlay__ {
			compatible = "mediatek,phy_tuning";
			u2_enhance = <0x2>;
			u2_term_ref = <0x6>;
			u2_vrt_ref = <0x6>;
		};
	};

	fragment@50 {
		target = <0xffffffff>;

		__overlay__ {
			#address-cells = <0x1>;
			#size-cells = <0x0>;
			clock-frequency = <0x61a80>;
			mediatek,use-open-drain;
		};
	};

	fragment@51 {
		target = <0xffffffff>;

		__overlay__ {
			#address-cells = <0x1>;
			#size-cells = <0x0>;
			clock-frequency = <0x61a80>;
			mediatek,use-open-drain;

			camera_main@6c {
				compatible = "mediatek,camera_main";
				phandle = <0x8c>;
				reg = <0x6c>;
				status = "okay";
			};

			camera_main_af@18 {
				compatible = "mediatek,camera_main_af";
				phandle = <0x8d>;
				reg = <0x18>;
				status = "okay";
			};
		};
	};

	fragment@52 {
		target = <0xffffffff>;

		__overlay__ {
			#address-cells = <0x1>;
			#size-cells = <0x0>;
			clock-frequency = <0x61a80>;
			mediatek,use-open-drain;
		};
	};

	fragment@53 {
		target = <0xffffffff>;

		__overlay__ {
			#address-cells = <0x1>;
			#size-cells = <0x0>;
			clock-frequency = <0x61a80>;
			mediatek,use-open-drain;

			camera_sub@34 {
				compatible = "mediatek,camera_sub";
				phandle = <0x8f>;
				reg = <0x34>;
				status = "okay";
			};

			camera_sub_two@78 {
				compatible = "mediatek,camera_sub_two";
				phandle = <0x8e>;
				reg = <0x78>;
				status = "okay";
			};
		};
	};

	fragment@54 {
		target = <0xffffffff>;

		__overlay__ {
			#address-cells = <0x1>;
			#size-cells = <0x0>;
			clock-frequency = <0x33e140>;
			mediatek,use-push-pull;

			subpmic@34 {
				compatible = "mediatek,subpmic";
				phandle = <0x90>;
				reg = <0x34>;
				status = "okay";
			};

			subpmic_ldo@64 {
				compatible = "mediatek,subpmic_ldo";
				phandle = <0x93>;
				reg = <0x64>;
				status = "okay";
			};

			subpmic_pmic@1a {
				compatible = "mediatek,subpmic_pmic";
				phandle = <0x92>;
				reg = <0x1a>;
				status = "okay";
			};

			usb_type_c@4e {
				compatible = "mediatek,usb_type_c";
				phandle = <0x91>;
				reg = <0x4e>;
				status = "okay";
			};
		};
	};

	fragment@55 {
		target = <0xffffffff>;

		__overlay__ {
			#address-cells = <0x1>;
			#size-cells = <0x0>;
			clock-frequency = <0x61a80>;
			mediatek,use-open-drain;
		};
	};

	fragment@56 {
		target = <0xffffffff>;

		__overlay__ {
			#address-cells = <0x1>;
			#size-cells = <0x0>;
			clock-frequency = <0x61a80>;
			mediatek,use-open-drain;
		};
	};

	fragment@57 {
		target = <0xffffffff>;

		__overlay__ {
			#address-cells = <0x1>;
			#size-cells = <0x0>;
			clock-frequency = <0x61a80>;
			mediatek,use-open-drain;

			camera_main_two@6e {
				compatible = "mediatek,camera_main_two";
				phandle = <0x94>;
				reg = <0x6e>;
				status = "okay";
			};
		};
	};

	fragment@58 {
		target = <0xffffffff>;

		__overlay__ {
			#address-cells = <0x1>;
			#size-cells = <0x0>;
			clock-frequency = <0x61a80>;
			mediatek,use-open-drain;

			camera_main_three@10 {
				compatible = "mediatek,camera_main_three";
				phandle = <0x95>;
				reg = <0x10>;
				status = "okay";
			};
		};
	};

	fragment@59 {
		target = <0xffffffff>;

		__overlay__ {
			GPIO_FDD_BAND_SUPPORT_DETECT_1ST_PIN = <0xffffffff 0xa6 0x0>;
			GPIO_FDD_BAND_SUPPORT_DETECT_2ND_PIN = <0xffffffff 0xa7 0x0>;
			GPIO_FDD_BAND_SUPPORT_DETECT_3RD_PIN = <0xffffffff 0xa8 0x0>;
			GPIO_FDD_BAND_SUPPORT_DETECT_4TH_PIN = <0xffffffff 0xa9 0x0>;
			GPIO_RF_PWREN_RST_PIN = <0xffffffff 0xab 0x0>;
			GPIO_SIM1_HOT_PLUG = <0xffffffff 0x4d 0x0>;
			GPIO_SIM1_SCLK = <0xffffffff 0x7c 0x0>;
			GPIO_SIM1_SIO = <0xffffffff 0x7a 0x0>;
			GPIO_SIM1_SRST = <0xffffffff 0x7b 0x0>;
			GPIO_SIM2_HOT_PLUG = <0xffffffff 0x4e 0x0>;
			GPIO_SIM2_SCLK = <0xffffffff 0x77 0x0>;
			GPIO_SIM2_SIO = <0xffffffff 0x79 0x0>;
			GPIO_SIM2_SRST = <0xffffffff 0x78 0x0>;
		};
	};

	fragment@6 {
		target = <0xffffffff>;

		__overlay__ {
			support_tuv_authentication;
		};
	};

	fragment@60 {
		target = <0xffffffff>;

		__overlay__ {
			gpio_init_default = <0x0 0x0 0x0 0x0 0x1 0x0 0x1 0x1 0x0 0x0 0x0 0x1 0x1 0x1 0x2 0x0 0x0 0x0 0x1 0x1 0x1 0x3 0x0 0x0 0x0 0x1 0x0 0x1 0x4 0x0 0x0 0x0 0x1 0x1 0x1 0x5 0x0 0x0 0x0 0x1 0x0 0x1 0x6 0x0 0x0 0x0 0x1 0x1 0x1 0x7 0x0 0x0 0x0 0x1 0x1 0x1 0x8 0x7 0x0 0x0 0x1 0x0 0x1 0x9 0x0 0x0 0x0 0x1 0x1 0x1 0xa 0x0 0x0 0x0 0x1 0x1 0x1 0xb 0x0 0x1 0x0 0x1 0x0 0x0 0xc 0x2 0x0 0x0 0x0 0x0 0x0 0xd 0x2 0x1 0x0 0x1 0x0 0x0 0xe 0x0 0x0 0x0 0x1 0x1 0x1 0xf 0x0 0x1 0x0 0x1 0x0 0x1 0x10 0x7 0x0 0x0 0x1 0x0 0x1 0x11 0x7 0x0 0x0 0x1 0x0 0x1 0x12 0x7 0x0 0x0 0x1 0x0 0x1 0x13 0x7 0x0 0x0 0x0 0x0 0x1 0x14 0x7 0x0 0x0 0x1 0x0 0x1 0x15 0x0 0x1 0x0 0x1 0x0 0x1 0x16 0x7 0x0 0x0 0x1 0x0 0x1 0x17 0x7 0x0 0x0 0x1 0x0 0x1 0x18 0x7 0x0 0x0 0x1 0x0 0x1 0x19 0x7 0x0 0x0 0x1 0x0 0x1 0x1a 0x7 0x0 0x0 0x1 0x0 0x1 0x1b 0x1 0x0 0x0 0x0 0x0 0x1 0x1c 0x1 0x0 0x0 0x0 0x0 0x1 0x1d 0x1 0x0 0x0 0x0 0x0 0x1 0x1e 0x1 0x0 0x0 0x1 0x0 0x1 0x1f 0x2 0x0 0x0 0x0 0x0 0x1 0x20 0x2 0x0 0x0 0x0 0x0 0x1 0x21 0x2 0x0 0x0 0x0 0x0 0x1 0x22 0x2 0x0 0x0 0x1 0x0 0x1 0x23 0x1 0x0 0x0 0x0 0x0 0x1 0x24 0x0 0x1 0x0 0x0 0x0 0x0 0x25 0x1 0x0 0x0 0x0 0x0 0x1 0x26 0x1 0x0 0x0 0x1 0x0 0x1 0x27 0x0 0x0 0x0 0x1 0x1 0x1 0x28 0x1 0x0 0x0 0x0 0x0 0x1 0x29 0x1 0x0 0x0 0x0 0x0 0x1 0x2a 0x1 0x0 0x0 0x1 0x0 0x1 0x2b 0x1 0x0 0x0 0x0 0x0 0x1 0x2c 0x0 0x0 0x0 0x1 0x0 0x1 0x2d 0x0 0x0 0x0 0x1 0x0 0x1 0x2e 0x0 0x0 0x0 0x1 0x0 0x1 0x2f 0x0 0x0 0x0 0x1 0x0 0x1 0x30 0x0 0x0 0x0 0x1 0x0 0x1 0x31 0x0 0x1 0x0 0x1 0x0 0x0 0x32 0x0 0x1 0x0 0x1 0x0 0x0 0x33 0x0 0x1 0x0 0x1 0x0 0x0 0x34 0x0 0x1 0x0 0x1 0x0 0x0 0x35 0x0 0x1 0x0 0x1 0x0 0x0 0x36 0x0 0x1 0x0 0x1 0x0 0x1 0x37 0x0 0x1 0x0 0x1 0x0 0x1 0x38 0x0 0x1 0x0 0x1 0x0 0x1 0x39 0x0 0x0 0x0 0x1 0x0 0x1 0x3a 0x0 0x1 0x0 0x1 0x0 0x1 0x3b 0x1 0x0 0x0 0x1 0x0 0x1 0x3c 0x0 0x1 0x0 0x1 0x0 0x1 0x3d 0x1 0x0 0x0 0x1 0x1 0x0 0x3e 0x1 0x0 0x0 0x0 0x0 0x0 0x3f 0x1 0x0 0x0 0x1 0x1 0x1 0x40 0x1 0x0 0x0 0x0 0x0 0x1 0x41 0x1 0x0 0x0 0x0 0x0 0x0 0x42 0x1 0x0 0x0 0x0 0x0 0x0 0x43 0x1 0x0 0x0 0x1 0x1 0x0 0x44 0x1 0x0 0x0 0x0 0x0 0x0 0x45 0x1 0x0 0x0 0x1 0x1 0x0 0x46 0x1 0x0 0x0 0x1 0x1 0x0 0x47 0x1 0x0 0x0 0x1 0x1 0x0 0x48 0x1 0x0 0x0 0x1 0x1 0x0 0x49 0x1 0x0 0x0 0x1 0x1 0x0 0x4a 0x1 0x0 0x0 0x1 0x1 0x0 0x4b 0x1 0x0 0x0 0x1 0x1 0x0 0x4c 0x1 0x0 0x0 0x1 0x1 0x0 0x4d 0x1 0x0 0x0 0x1 0x1 0x1 0x4e 0x1 0x0 0x0 0x1 0x1 0x1 0x4f 0x1 0x0 0x0 0x1 0x1 0x1 0x50 0x1 0x0 0x0 0x1 0x1 0x0 0x51 0x1 0x0 0x0 0x1 0x0 0x0 0x52 0x0 0x1 0x0 0x1 0x0 0x1 0x53 0x1 0x0 0x0 0x0 0x0 0x1 0x54 0x1 0x0 0x0 0x1 0x0 0x1 0x55 0x1 0x0 0x0 0x0 0x0 0x1 0x56 0x0 0x1 0x0 0x1 0x0 0x0 0x57 0x2 0x0 0x0 0x1 0x0 0x1 0x58 0x0 0x0 0x0 0x1 0x0 0x1 0x59 0x0 0x0 0x0 0x1 0x0 0x1 0x5a 0x1 0x0 0x0 0x0 0x0 0x1 0x5b 0x0 0x0 0x0 0x1 0x0 0x1 0x5c 0x0 0x1 0x0 0x1 0x0 0x1 0x5d 0x0 0x1 0x0 0x1 0x0 0x1 0x5e 0x0 0x1 0x0 0x1 0x0 0x1 0x5f 0x1 0x0 0x0 0x1 0x0 0x1 0x60 0x1 0x0 0x0 0x1 0x0 0x1 0x61 0x2 0x1 0x0 0x1 0x0 0x0 0x62 0x2 0x1 0x0 0x1 0x0 0x0 0x63 0x2 0x0 0x0 0x1 0x1 0x1 0x64 0x2 0x0 0x0 0x1 0x1 0x1 0x65 0x1 0x0 0x0 0x1 0x1 0x1 0x66 0x1 0x0 0x0 0x1 0x1 0x1 0x67 0x1 0x0 0x0 0x1 0x1 0x1 0x68 0x1 0x0 0x0 0x1 0x1 0x1 0x69 0x1 0x0 0x0 0x1 0x1 0x1 0x6a 0x1 0x0 0x0 0x1 0x1 0x1 0x6b 0x1 0x0 0x0 0x1 0x1 0x1 0x6c 0x1 0x0 0x0 0x1 0x1 0x1 0x6d 0x1 0x0 0x0 0x1 0x1 0x1 0x6e 0x1 0x0 0x0 0x1 0x1 0x1 0x6f 0x1 0x0 0x0 0x1 0x1 0x1 0x70 0x1 0x0 0x0 0x1 0x1 0x1 0x71 0x1 0x0 0x0 0x1 0x1 0x1 0x72 0x1 0x0 0x0 0x1 0x1 0x1 0x73 0x1 0x0 0x0 0x1 0x0 0x1 0x74 0x1 0x0 0x0 0x1 0x0 0x1 0x75 0x0 0x0 0x0 0x1 0x0 0x1 0x76 0x0 0x0 0x0 0x1 0x0 0x1 0x77 0x1 0x0 0x0 0x0 0x0 0x1 0x78 0x1 0x0 0x0 0x0 0x0 0x1 0x79 0x1 0x0 0x0 0x1 0x1 0x1 0x7a 0x1 0x0 0x0 0x1 0x1 0x1 0x7b 0x1 0x0 0x0 0x0 0x0 0x1 0x7c 0x1 0x0 0x0 0x0 0x0 0x1 0x7d 0x1 0x0 0x0 0x0 0x0 0x1 0x7e 0x1 0x0 0x0 0x1 0x1 0x1 0x7f 0x1 0x0 0x0 0x1 0x1 0x1 0x80 0x1 0x0 0x0 0x1 0x1 0x1 0x81 0x1 0x0 0x0 0x1 0x1 0x1 0x82 0x1 0x0 0x0 0x1 0x1 0x1 0x83 0x0 0x1 0x0 0x1 0x0 0x1 0x84 0x0 0x1 0x0 0x1 0x0 0x1 0x85 0x0 0x1 0x0 0x1 0x0 0x1 0x86 0x0 0x1 0x0 0x1 0x0 0x1 0x87 0x0 0x1 0x0 0x1 0x0 0x1 0x88 0x0 0x1 0x1 0x1 0x0 0x1 0x89 0x0 0x1 0x0 0x1 0x0 0x1 0x8a 0x0 0x1 0x0 0x1 0x0 0x1 0x8b 0x0 0x1 0x0 0x1 0x0 0x0 0x8c 0x0 0x1 0x1 0x1 0x0 0x1 0x8d 0x2 0x0 0x0 0x1 0x0 0x1 0x8e 0x2 0x0 0x0 0x1 0x0 0x1 0x8f 0x1 0x0 0x0 0x0 0x0 0x1 0x90 0x1 0x0 0x0 0x0 0x0 0x1 0x91 0x1 0x0 0x0 0x0 0x0 0x1 0x92 0x1 0x0 0x0 0x0 0x0 0x1 0x93 0x1 0x0 0x0 0x0 0x0 0x1 0x94 0x1 0x0 0x0 0x0 0x0 0x1 0x95 0x1 0x0 0x0 0x1 0x0 0x1 0x96 0x1 0x0 0x0 0x1 0x0 0x1 0x97 0x1 0x0 0x0 0x1 0x0 0x1 0x98 0x1 0x0 0x0 0x1 0x0 0x1 0x99 0x1 0x0 0x0 0x0 0x0 0x1 0x9a 0x1 0x0 0x0 0x0 0x0 0x1 0x9b 0x1 0x0 0x0 0x0 0x0 0x1 0x9c 0x1 0x0 0x0 0x0 0x0 0x1 0x9d 0x1 0x0 0x0 0x0 0x0 0x1 0x9e 0x1 0x0 0x0 0x0 0x0 0x1 0x9f 0x1 0x0 0x0 0x1 0x0 0x1 0xa0 0x1 0x0 0x0 0x1 0x0 0x1 0xa1 0x1 0x0 0x0 0x1 0x0 0x1 0xa2 0x1 0x0 0x0 0x0 0x0 0x0 0xa3 0x1 0x0 0x0 0x1 0x0 0x0 0xa4 0x1 0x0 0x0 0x1 0x0 0x1 0xa5 0x1 0x0 0x0 0x1 0x0 0x1 0xa6 0x0 0x0 0x0 0x1 0x0 0x0 0xa7 0x0 0x0 0x0 0x1 0x0 0x0 0xa8 0x0 0x0 0x0 0x1 0x0 0x0 0xa9 0x0 0x0 0x0 0x1 0x0 0x0 0xaa 0x1 0x0 0x0 0x0 0x0 0x1 0xab 0x0 0x1 0x1 0x1 0x0 0x1 0xac 0x1 0x0 0x0 0x0 0x0 0x1 0xad 0x1 0x0 0x0 0x0 0x0 0x1 0xae 0x1 0x0 0x0 0x0 0x0 0x1 0xaf 0x1 0x0 0x0 0x0 0x0 0x1 0xb0 0x1 0x0 0x0 0x0 0x0 0x1 0xb1 0x1 0x0 0x0 0x0 0x0 0x1 0xb2 0x1 0x0 0x0 0x0 0x0 0x1 0xb3 0x1 0x0 0x0 0x0 0x0 0x1 0xb4 0x1 0x0 0x0 0x0 0x0 0x1 0xb5 0x1 0x0 0x0 0x0 0x0 0x1 0xb6 0x1 0x0 0x0 0x0 0x0 0x1 0xb7 0x1 0x0 0x0 0x0 0x0 0x1 0xb8 0x1 0x0 0x0 0x0 0x0 0x1 0xb9 0x1 0x0 0x0 0x0 0x0 0x1 0xba 0x1 0x0 0x0 0x0 0x0 0x1 0xbb 0x1 0x0 0x0 0x0 0x0 0x1 0xbc 0x1 0x0 0x0 0x0 0x0 0x0 0xbd 0x1 0x0 0x0 0x1 0x0 0x0 0xbe 0x1 0x0 0x0 0x0 0x0 0x0 0xbf 0x1 0x0 0x0 0x1 0x0 0x0 0xc0 0x0 0x0 0x0 0x1 0x0 0x1 0xc1 0x0 0x0 0x0 0x1 0x0 0x1 0xc2 0x0 0x0 0x0 0x1 0x0 0x1 0xc3 0x0 0x0 0x0 0x1 0x0 0x1 0xc4 0x0 0x0 0x0 0x1 0x0 0x1 0xc5 0x0 0x0 0x0 0x1 0x0 0x1 0xc6 0x0 0x0 0x0 0x1 0x0 0x1 0xc7 0x0 0x0 0x0 0x1 0x0 0x1 0xc8 0x0 0x0 0x0 0x1 0x0 0x1>;
		};
	};

	fragment@61 {
		target = <0xffffffff>;

		__overlay__ {
			deb-gpios = <0xffffffff 0x1 0x0>;
			debounce = <0x7d000>;
			interrupt-parent = <0xffffffff>;
			interrupts = <0x1 0x8>;
			status = "okay";
		};
	};

	fragment@62 {
		target = <0xffffffff>;

		__overlay__ {
			deb-gpios = <0xffffffff 0x7 0x0>;
			debounce = <0x7d000>;
			interrupt-parent = <0xffffffff>;
			interrupts = <0x7 0x4>;
			status = "okay";
		};
	};

	fragment@63 {
		target = <0xffffffff>;

		__overlay__ {
			interrupt-parent = <0xffffffff>;
			interrupts = <0xa 0x2>;
			status = "okay";
		};
	};

	fragment@64 {
		target = <0xffffffff>;

		__overlay__ {
			interrupt-parent = <0xffffffff>;
			interrupts = <0xe 0x8>;
			status = "okay";
		};
	};

	fragment@65 {
		target = <0xffffffff>;

		__overlay__ {
			interrupt-parent = <0xffffffff>;
			interrupts = <0x54 0x1>;
			status = "okay";
		};
	};

	fragment@66 {
		target = <0xffffffff>;

		__overlay__ {
			compatible = "mediatek,md1_sim1_hot_plug_eint-eint";
			debounce = <0x0 0xc350>;
			dedicated = <0x0 0x0>;
			interrupts = <0x0 0x8>;
			sockettype = <0x0 0x0>;
			src_pin = <0x0 0x1>;
			status = "okay";
		};
	};

	fragment@67 {
		target = <0xffffffff>;

		__overlay__ {
			compatible = "mediatek,md1_sim2_hot_plug_eint-eint";
			debounce = <0x1 0xc350>;
			dedicated = <0x1 0x0>;
			interrupts = <0x1 0x8>;
			sockettype = <0x1 0x0>;
			src_pin = <0x1 0x2>;
			status = "okay";
		};
	};

	fragment@68 {
		target = <0xffffffff>;

		__overlay__ {
			regulator-default-on = <0x1>;
			regulator-name = "vcamio";
			status = "okay";
		};
	};

	fragment@69 {
		target = <0xffffffff>;

		__overlay__ {
			regulator-default-on = <0x1>;
			regulator-name = "vtp";
			status = "okay";
		};
	};

	fragment@7 {
		target = <0xffffffff>;

		__overlay__ {
			io-channel-names = "auxadc3-chargeric_temp", "auxadc4-usb_temp_v_l", "auxadc5-usb_temp_v_r";
			io-channels = <0xffffffff 0x3 0xffffffff 0x4 0xffffffff 0x5>;
			pinctrl-0 = <0x1>;
			pinctrl-1 = <0x2>;
			pinctrl-2 = <0x3>;
			pinctrl-names = "default", "dischg_enable", "dischg_disable";
			qcom,batt_capacity_mah = <0x1388>;
			qcom,charger_hv_thr = <0x16a8>;
			qcom,charger_lv_thr = <0xd48>;
			qcom,check_batt_full_by_sw;
			qcom,chg_ctrl_by_calling;
			qcom,chg_ctrl_by_camera;
			qcom,chg_ctrl_by_lcd;
			qcom,cold_bat_decidegc = <0x14>;
			qcom,cold_vfloat_over_sw_limit = <0xf96>;
			qcom,cold_vfloat_sw_limit = <0xf5a>;
			qcom,cool_bat_decidegc = <0x32>;
			qcom,cool_vfloat_over_sw_limit = <0x115d>;
			qcom,cool_vfloat_sw_limit = <0x1121>;
			qcom,default_iterm_ma = <0xfe>;
			qcom,default_normal_vfloat_over_sw_limit = <0x115d>;
			qcom,default_normal_vfloat_sw_limit = <0x1121>;
			qcom,default_temp_normal_fastchg_current_ma = <0x898>;
			qcom,default_temp_normal_vfloat_mv = <0x1153>;
			qcom,dischg-gpio = <0xffffffff 0x86 0x0>;
			qcom,external_gauge;
			qcom,g_rap_pull_up_r0 = <0x186a0>;
			qcom,hot_bat_decidegc = <0x212>;
			qcom,input_current_calling_ma = <0x5dc>;
			qcom,input_current_camera_ma = <0x7d0>;
			qcom,input_current_cdp_ma = <0x640>;
			qcom,input_current_charger_ma = <0x898>;
			qcom,input_current_led_ma = <0x4b0>;
			qcom,input_current_led_ma_forcmcc = <0x1f4>;
			qcom,input_current_led_ma_high = <0x4b0>;
			qcom,input_current_led_ma_normal = <0x7d0>;
			qcom,input_current_led_ma_warm = <0x5dc>;
			qcom,input_current_usb_ma = <0x1f4>;
			qcom,iterm_disabled = <0x0>;
			qcom,iterm_ma = <0xfe>;
			qcom,little_cold_bat_decidegc = <0x0>;
			qcom,little_cold_vfloat_over_sw_limit = <0x115d>;
			qcom,little_cold_vfloat_sw_limit = <0x1121>;
			qcom,little_cool_bat_decidegc = <0x78>;
			qcom,little_cool_vfloat_over_sw_limit = <0x115d>;
			qcom,little_cool_vfloat_sw_limit = <0x1121>;
			qcom,max_chg_time_sec = <0xf1e0>;
			qcom,new_ui_warning_support;
			qcom,non_normal_vterm_hw_inc = <0x12>;
			qcom,non_standard_fastchg_current_ma = <0x200>;
			qcom,non_standard_vfloat_mv = <0xf8c>;
			qcom,non_standard_vfloat_over_sw_limit = <0xf96>;
			qcom,non_standard_vfloat_sw_limit = <0xf5a>;
			qcom,normal_bat_decidegc = <0xa0>;
			qcom,normal_vfloat_over_sw_limit = <0x115d>;
			qcom,normal_vfloat_sw_limit = <0x1121>;
			qcom,normal_vterm_hw_inc = <0x12>;
			qcom,pd_not_support = <0x1>;
			qcom,qc_input_current_charger_ma = <0x7d0>;
			qcom,qc_not_support = <0x1>;
			qcom,qc_temp_cool_fastchg_current_ma_high = <0x898>;
			qcom,qc_temp_cool_fastchg_current_ma_low = <0x898>;
			qcom,qc_temp_little_cold_fastchg_current_ma_high = <0x898>;
			qcom,qc_temp_little_cold_fastchg_current_ma_low = <0x564>;
			qcom,qc_temp_little_cool_fastchg_current_ma = <0x898>;
			qcom,qc_temp_little_cool_fastchg_current_ma_high = <0x898>;
			qcom,qc_temp_little_cool_fastchg_current_ma_low = <0x898>;
			qcom,qc_temp_normal_fastchg_current_ma = <0x898>;
			qcom,qc_temp_warm_fastchg_current_ma = <0x546>;
			qcom,recharge-mv = <0x64>;
			qcom,removed_bat_decidegc = <0xbe>;
			qcom,short_c_bat_cv_mv = <0x10ea>;
			qcom,short_c_bat_fastchg_current_ma = <0x200>;
			qcom,short_c_bat_vfloat_mv = <0xed8>;
			qcom,short_c_bat_vfloat_sw_limit = <0xea6>;
			qcom,support_ntc_01c_precision;
			qcom,sw_vfloat_over_protect_enable;
			qcom,temp_cold_fastchg_current_ma = <0x15e>;
			qcom,temp_cold_vfloat_mv = <0xf8c>;
			qcom,temp_cool_fastchg_current_ma_high = <0x898>;
			qcom,temp_cool_fastchg_current_ma_low = <0x898>;
			qcom,temp_cool_vfloat_mv = <0x1153>;
			qcom,temp_little_cold_fastchg_current_ma = <0x898>;
			qcom,temp_little_cold_fastchg_current_ma_high = <0x898>;
			qcom,temp_little_cold_fastchg_current_ma_low = <0x564>;
			qcom,temp_little_cold_vfloat_mv = <0x1153>;
			qcom,temp_little_cool_fastchg_current_ma = <0x898>;
			qcom,temp_little_cool_fastchg_current_ma_high = <0x898>;
			qcom,temp_little_cool_fastchg_current_ma_low = <0x898>;
			qcom,temp_little_cool_vfloat_mv = <0x1153>;
			qcom,temp_normal_fastchg_current_ma = <0x898>;
			qcom,temp_normal_vfloat_mv = <0x1153>;
			qcom,temp_warm_fastchg_current_ma = <0x546>;
			qcom,temp_warm_fastchg_current_ma_led_on = <0x1f4>;
			qcom,temp_warm_vfloat_mv = <0x1022>;
			qcom,usbtemp_batttemp_gap = <0xc>;
			qcom,vbatt_full_thr = <0x1162>;
			qcom,vbatt_hv_thr = <0x11c6>;
			qcom,vbatt_num = <0x1>;
			qcom,vbatt_power_off = <0xce4>;
			qcom,vbatt_soc_1 = <0xd52>;
			qcom,vfloat_step_mv = <0x8>;
			qcom,warm_bat_decidegc = <0x1c2>;
			qcom,warm_vfloat_over_sw_limit = <0x102c>;
			qcom,warm_vfloat_sw_limit = <0xff0>;
		};
	};

	fragment@70 {
		target = <0xffffffff>;

		__overlay__ {
			status = "okay";
		};
	};

	fragment@71 {
		target = <0xffffffff>;

		__overlay__ {
			status = "okay";
			vtouch-supply = <0xffffffff>;
		};
	};

	fragment@72 {
		target = <0xffffffff>;

		__overlay__ {
			mediatek,kpd-hw-dl-key0 = <0x11>;
			mediatek,kpd-hw-dl-key1 = <0x0>;
			mediatek,kpd-hw-dl-key2 = <0x8>;
			mediatek,kpd-hw-factory-key = <0x0>;
			mediatek,kpd-hw-init-map = <0x72 0x0 0x0 0x0 0x0 0x0 0x0 0x0 0x0 0x0 0x0 0x0 0x0 0x0 0x0 0x0 0x0 0x0 0x0 0x0 0x0 0x0 0x0 0x0 0x0 0x0 0x0 0x0 0x0 0x0 0x0 0x0 0x0 0x0 0x0 0x0 0x0 0x0 0x0 0x0 0x0 0x0 0x0 0x0 0x0 0x0 0x0 0x0 0x0 0x0 0x0 0x0 0x0 0x0 0x0 0x0 0x0 0x0 0x0 0x0 0x0 0x0 0x0 0x0 0x0 0x0 0x0 0x0 0x0 0x0 0x0 0x0>;
			mediatek,kpd-hw-map-num = <0x48>;
			mediatek,kpd-hw-pwrkey = <0x8>;
			mediatek,kpd-hw-recovery-key = <0x11>;
			mediatek,kpd-hw-rstkey = <0x11>;
			mediatek,kpd-key-debounce = <0x400>;
			mediatek,kpd-pwkey-gpio-din = <0x0>;
			mediatek,kpd-pwrkey-eint-gpio = <0x0>;
			mediatek,kpd-sw-pwrkey = <0x74>;
			mediatek,kpd-sw-rstkey = <0x73>;
			mediatek,kpd-use-extend-type = <0x0>;
			status = "okay";
		};
	};

	fragment@8 {
		target = <0xffffffff>;

		__overlay__ {
			FUELGAGUE_APPLY = <0x1>;
			IS_4450MV_BATTERY_SUPPORT = <0x1>;
			R_FG_VALUE = <0xa>;
			battery0_profile_t0 = <0x0 0xacaa 0x3d4 0x3a3 0x1ef 0xac3c 0x3d6 0x3a5 0x3de 0xabd9 0x3e2 0x3b0 0x5cd 0xab7a 0x3ee 0x3bc 0x7bc 0xab1a 0x3ec 0x3ba 0x9ab 0xaab7 0x3eb 0x3b9 0xb9a 0xaa52 0x3f3 0x3c1 0xd89 0xa9e9 0x3f3 0x3c1 0xf78 0xa97c 0x3f3 0x3c1 0x1167 0xa90e 0x3f3 0x3c1 0x1356 0xa8a0 0x3fe 0x3cb 0x1545 0xa82f 0x401 0x3cd 0x1733 0xa7bc 0x409 0x3d5 0x1922 0xa745 0x400 0x3cd 0x1b11 0xa6cd 0x3f7 0x3c4 0x1d00 0xa653 0x3fd 0x3ca 0x1eef 0xa5d5 0x3f3 0x3c1 0x20de 0xa55d 0x401 0x3cd 0x22cd 0xa4e4 0x3ff 0x3cb 0x24bc 0xa46c 0x40b 0x3d7 0x26ab 0xa3ef 0x403 0x3d0 0x289a 0xa375 0x407 0x3d3 0x2a89 0xa2fd 0x40e 0x3da 0x2c78 0xa286 0x412 0x3de 0x2e67 0xa211 0x41b 0x3e7 0x3056 0xa19a 0x41b 0x3e7 0x3245 0xa127 0x41b 0x3e7 0x3434 0xa0b4 0x429 0x3f3 0x3623 0xa040 0x429 0x3f4 0x3812 0x9fd1 0x429 0x3f3 0x3a01 0x9f6a 0x43e 0x408 0x3bf0 0x9f03 0x453 0x408 0x3ddf 0x9e97 0x457 0x3e8 0x3fce 0x9e2f 0x45e 0x3e6 0x41bc 0x9dc6 0x454 0x3dc 0x43ab 0x9d5e 0x460 0x3b9 0x459a 0x9cfb 0x46d 0x3ce 0x4789 0x9c9d 0x483 0x3d4 0x4978 0x9c3c 0x493 0x3ce 0x4b67 0x9bda 0x4a5 0x3c5 0x4d56 0x9b77 0x4bc 0x3bd 0x4f45 0x9b0d 0x4c5 0x3b8 0x5134 0x9a8b 0x49b 0x3bf 0x5323 0x99e7 0x447 0x3b6 0x5512 0x995d 0x415 0x3d0 0x5701 0x98f1 0x404 0x3b6 0x58f0 0x9894 0x3f8 0x3ac 0x5adf 0x9846 0x3f2 0x3ac 0x5cce 0x97fc 0x3f1 0x3b4 0x5ebd 0x97b5 0x3f5 0x3bd 0x60ac 0x9777 0x3fe 0x3b6 0x629b 0x9731 0x3f4 0x3b7 0x648a 0x96fb 0x400 0x3bf 0x6679 0x96be 0x3ff 0x3c0 0x6868 0x9686 0x3fe 0x3b2 0x6a57 0x964c 0x3f6 0x3b2 0x6c45 0x9615 0x3f1 0x3ba 0x6e34 0x95e6 0x3fb 0x3c8 0x7023 0x95b9 0x40e 0x3da 0x7212 0x9589 0x410 0x3d7 0x7401 0x955c 0x41b 0x3c0 0x75f0 0x952c 0x40f 0x3b7 0x77df 0x9504 0x418 0x3b6 0x79ce 0x94de 0x42f 0x3bd 0x7bbd 0x94bb 0x440 0x3c0 0x7dac 0x9495 0x440 0x3bc 0x7f9b 0x946c 0x441 0x3b6 0x818a 0x944a 0x453 0x3b6 0x8379 0x9423 0x452 0x3b5 0x8568 0x93f8 0x446 0x3ac 0x8757 0x93b1 0x422 0x3a4 0x8946 0x935d 0x3fe 0x3b8 0x8b35 0x9315 0x3f3 0x3c1 0x8d24 0x92df 0x400 0x3cd 0x8f13 0x92b1 0x40e 0x3da 0x9102 0x927e 0x40a 0x3d7 0x92f1 0x9249 0x403 0x3cf 0x94e0 0x921c 0x40e 0x3d9 0x96ce 0x91f1 0x41a 0x3c2 0x98bd 0x91c5 0x411 0x3b8 0x9aac 0x919a 0x40e 0x3b6 0x9c9b 0x9163 0x40e 0x3b6 0x9e8a 0x9124 0x408 0x3b2 0xa079 0x90e4 0x401 0x3ac 0xa268 0x90a8 0x403 0x3b6 0xa457 0x9069 0x40a 0x3d6 0xa646 0x9011 0x3e4 0x3b2 0xa835 0x8fd9 0x3cc 0x39c 0xaa24 0x8fc8 0x3e9 0x3b7 0xac13 0x8fbd 0x404 0x3d1 0xae02 0x8faf 0x41c 0x3e7 0xaff1 0x8fa1 0x44b 0x414 0xb1e0 0x8f8a 0x491 0x457 0xb3cf 0x8f36 0x4b0 0x474 0xb5be 0x8e42 0x453 0x41c 0xb7ad 0x8c7c 0x453 0x41c 0xb99c 0x8a1d 0x474 0x43b 0xbb8b 0x86cb 0x4ca 0x48c 0xbd7a 0x8149 0x637 0x5e7 0xbf69 0x7e3c 0x2e63 0x2c11>;
			battery0_profile_t0_col = <0x4>;
			battery0_profile_t0_num = <0x64>;
			battery0_profile_t1 = <0x0 0xac53 0x514 0x44c 0x1ef 0xabf1 0x515 0x44c 0x3de 0xab93 0x520 0x44c 0x5cd 0xab36 0x523 0x44c 0x7bc 0xaad6 0x523 0x44c 0x9ab 0xaa71 0x523 0x44c 0xb9a 0xaa09 0x527 0x44c 0xd89 0xa9a1 0x532 0x44c 0xf78 0xa939 0x530 0x44c 0x1167 0xa8c6 0x532 0x44c 0x1356 0xa84e 0x531 0x44c 0x1545 0xa7d5 0x530 0x44c 0x1733 0xa75d 0x530 0x44c 0x1922 0xa6e2 0x530 0x44c 0x1b11 0xa666 0x535 0x45d 0x1d00 0xa5ec 0x53e 0x47f 0x1eef 0xa56f 0x541 0x480 0x20de 0xa4f7 0x54b 0x47f 0x22cd 0xa479 0x54d 0x480 0x24bc 0xa400 0x54b 0x481 0x26ab 0xa388 0x542 0x481 0x289a 0xa313 0x54d 0x482 0x2a89 0xa29d 0x55a 0x482 0x2c78 0xa225 0x55d 0x483 0x2e67 0xa1ae 0x56a 0x483 0x3056 0xa13b 0x575 0x484 0x3245 0xa0c9 0x577 0x484 0x3434 0xa055 0x581 0x485 0x3623 0x9feb 0x58e 0x485 0x3812 0x9f80 0x59a 0x4a1 0x3a01 0x9f13 0x59a 0x4b5 0x3bf0 0x9ea7 0x59c 0x4ba 0x3ddf 0x9e3f 0x5b0 0x4c8 0x3fce 0x9dd8 0x5bd 0x4d9 0x41bc 0x9d75 0x5d5 0x4c2 0x43ab 0x9d13 0x5ef 0x4e3 0x459a 0x9cb0 0x5fc 0x4f3 0x4789 0x9c4a 0x608 0x4ff 0x4978 0x9be5 0x61c 0x511 0x4b67 0x9b79 0x61e 0x527 0x4d56 0x9af6 0x5ee 0x53a 0x4f45 0x9a5c 0x58b 0x545 0x5134 0x99bf 0x51f 0x541 0x5323 0x9941 0x4e2 0x4fa 0x5512 0x98e7 0x4de 0x4a1 0x5701 0x988f 0x4de 0x47c 0x58f0 0x9842 0x4de 0x464 0x5adf 0x97fb 0x4de 0x45f 0x5cce 0x97b7 0x4de 0x45e 0x5ebd 0x9775 0x4de 0x44f 0x60ac 0x9735 0x4de 0x457 0x629b 0x96fe 0x4de 0x44c 0x648a 0x96c2 0x4eb 0x457 0x6679 0x968b 0x4ed 0x44f 0x6868 0x9654 0x4e3 0x454 0x6a57 0x9620 0x4ec 0x452 0x6c45 0x95f1 0x4ff 0x451 0x6e34 0x95c3 0x502 0x45c 0x7023 0x9593 0x4ff 0x465 0x7212 0x9568 0x524 0x466 0x7401 0x9541 0x53b 0x47f 0x75f0 0x9516 0x54a 0x489 0x77df 0x94f4 0x556 0x48d 0x79ce 0x94cf 0x562 0x495 0x7bbd 0x94ab 0x56e 0x4a0 0x7dac 0x9489 0x576 0x4a7 0x7f9b 0x9464 0x574 0x4a4 0x818a 0x9442 0x568 0x49d 0x8379 0x941c 0x568 0x4a6 0x8568 0x93eb 0x551 0x4b2 0x8757 0x93b9 0x538 0x4b3 0x8946 0x938c 0x532 0x4a5 0x8b35 0x935d 0x531 0x495 0x8d24 0x932c 0x52b 0x488 0x8f13 0x92fb 0x51f 0x47d 0x9102 0x92ca 0x517 0x476 0x92f1 0x929f 0x523 0x48d 0x94e0 0x9279 0x523 0x480 0x96ce 0x925c 0x538 0x476 0x98bd 0x9230 0x53e 0x47b 0x9aac 0x91ff 0x546 0x48e 0x9c9b 0x91c8 0x54c 0x49a 0x9e8a 0x918c 0x550 0x49a 0xa079 0x9150 0x55b 0x49a 0xa268 0x9111 0x55b 0x499 0xa457 0x90bf 0x55b 0x48e 0xa646 0x907d 0x544 0x498 0xa835 0x9060 0x54a 0x4a3 0xaa24 0x9052 0x55e 0x48e 0xac13 0x9047 0x57d 0x47f 0xae02 0x9037 0x5a2 0x484 0xaff1 0x901c 0x5d5 0x498 0xb1e0 0x8fdc 0x612 0x4b7 0xb3cf 0x8f14 0x5d7 0x4d1 0xb5be 0x8d64 0x5bd 0x4ff 0xb7ad 0x8b1f 0x607 0x536 0xb99c 0x87e3 0x65d 0x4fd 0xbb8b 0x8278 0x794 0x4ea 0xbd7a 0x7f3a 0x30ed 0x5b9 0xbf69 0x7f3a 0x30ed 0x5b9>;
			battery0_profile_t1_col = <0x4>;
			battery0_profile_t1_num = <0x64>;
			battery0_profile_t2 = <0x0 0xaca4 0x834 0x566 0x1ef 0xac37 0x838 0x566 0x3de 0xabd7 0x86e 0x566 0x5cd 0xab76 0x87e 0x566 0x7bc 0xab16 0x7bc 0x566 0x9ab 0xaab9 0x77a 0x566 0xb9a 0xaa57 0x81b 0x566 0xd89 0xa9ec 0x851 0x566 0xf78 0xa97a 0x831 0x566 0x1167 0xa912 0x748 0x566 0x1356 0xa89f 0x7b5 0x566 0x1545 0xa828 0x812 0x566 0x1733 0xa7af 0x7f7 0x566 0x1922 0xa733 0x790 0x566 0x1b11 0xa6b7 0x77e 0x566 0x1d00 0xa63c 0x7d9 0x566 0x1eef 0xa5bf 0x7ea 0x566 0x20de 0xa545 0x776 0x566 0x22cd 0xa4c1 0x790 0x566 0x24bc 0xa448 0x759 0x566 0x26ab 0xa3cb 0x7c1 0x566 0x289a 0xa357 0x7a7 0x566 0x2a89 0xa2e4 0x797 0x5a9 0x2c78 0xa26b 0x7ac 0x606 0x2e67 0xa1f2 0x7b8 0x60f 0x3056 0xa17a 0x816 0x5c1 0x3245 0xa107 0x7a2 0x5cf 0x3434 0xa094 0x811 0x623 0x3623 0xa021 0x7cf 0x649 0x3812 0x9fb6 0x808 0x5c5 0x3a01 0x9f4a 0x7dd 0x5d0 0x3bf0 0x9edc 0x7f8 0x639 0x3ddf 0x9e70 0x854 0x684 0x3fce 0x9e06 0x84e 0x677 0x41bc 0x9d99 0x884 0x5eb 0x43ab 0x9d31 0x7d8 0x680 0x459a 0x9cc3 0x899 0x6bf 0x4789 0x9c59 0x85e 0x675 0x4978 0x9bf5 0x86a 0x655 0x4b67 0x9b85 0x81d 0x67e 0x4d56 0x9b04 0x7da 0x6b3 0x4f45 0x9a7f 0x7cf 0x692 0x5134 0x99ff 0x779 0x61c 0x5323 0x997c 0x73d 0x605 0x5512 0x9903 0x69d 0x5d9 0x5701 0x98a0 0x6e0 0x5c4 0x58f0 0x9846 0x6ec 0x4fb 0x5adf 0x97fa 0x6c9 0x51a 0x5cce 0x97b2 0x66c 0x554 0x5ebd 0x976d 0x66b 0x566 0x60ac 0x972c 0x6e4 0x55c 0x629b 0x96ec 0x6f7 0x50d 0x648a 0x96b5 0x65a 0x553 0x6679 0x9678 0x5e9 0x547 0x6868 0x9640 0x690 0x578 0x6a57 0x960e 0x704 0x583 0x6c45 0x95dd 0x6c7 0x574 0x6e34 0x95ae 0x6ac 0x56b 0x7023 0x9580 0x6ea 0x56b 0x7212 0x954e 0x719 0x56f 0x7401 0x9520 0x713 0x576 0x75f0 0x94fe 0x6b7 0x577 0x77df 0x94d8 0x6e8 0x561 0x79ce 0x94ac 0x718 0x54d 0x7bbd 0x9489 0x740 0x57a 0x7dac 0x9468 0x6ec 0x5a5 0x7f9b 0x944a 0x6c8 0x574 0x818a 0x942b 0x70a 0x533 0x8379 0x9406 0x749 0x555 0x8568 0x93e4 0x751 0x5aa 0x8757 0x93c4 0x6c1 0x5b2 0x8946 0x93ad 0x6a8 0x546 0x8b35 0x938e 0x708 0x54f 0x8d24 0x935c 0x72c 0x57c 0x8f13 0x9333 0x6dc 0x588 0x9102 0x930d 0x6cb 0x54e 0x92f1 0x92e1 0x715 0x514 0x94e0 0x92b2 0x72c 0x537 0x96ce 0x927f 0x702 0x574 0x98bd 0x9269 0x656 0x553 0x9aac 0x923d 0x6f2 0x4ea 0x9c9b 0x9207 0x746 0x51c 0x9e8a 0x91b4 0x73f 0x575 0xa079 0x9175 0x6b2 0x574 0xa268 0x9149 0x69e 0x526 0xa457 0x910c 0x73d 0x508 0xa646 0x90ad 0x78c 0x565 0xa835 0x9054 0x759 0x5ae 0xaa24 0x9054 0x627 0x561 0xac13 0x904e 0x6d8 0x502 0xae02 0x9044 0x7a8 0x53b 0xaff1 0x9021 0x821 0x5a6 0xb1e0 0x8ffc 0x7d2 0x5c4 0xb3cf 0x8fa1 0x751 0x592 0xb5be 0x8ea3 0x77c 0x586 0xb7ad 0x8cb4 0x860 0x5fa 0xb99c 0x89fc 0x91c 0x665 0xbb8b 0x863f 0x8b9 0x63a 0xbd7a 0x7f1a 0xbe9 0x60f 0xbf69 0x7dba 0x2d4e 0x6e3>;
			battery0_profile_t2_col = <0x4>;
			battery0_profile_t2_num = <0x64>;
			battery0_profile_t3 = <0x0 0xac03 0x10ea 0xcc7 0x1ef 0xab7b 0x10ea 0xcc7 0x3de 0xab06 0x1120 0xcf0 0x5cd 0xaa96 0x1126 0xcf4 0x7bc 0xaa29 0x110b 0xcdf 0x9ab 0xa9bc 0x10ec 0xcc8 0xb9a 0xa94d 0x10d4 0xcb6 0xd89 0xa8dc 0x10bc 0xca5 0xf78 0xa86f 0x10a4 0xc92 0x1167 0xa7f7 0x1081 0xc78 0x1356 0xa785 0x1073 0xc6d 0x1545 0xa70a 0x104a 0xc4f 0x1733 0xa690 0x1028 0xc34 0x1922 0xa618 0x1011 0xc23 0x1b11 0xa5a0 0xffe 0xc14 0x1d00 0xa528 0xff1 0xc0c 0x1eef 0xa4b0 0xfe3 0xc00 0x20de 0xa439 0xfcc 0xbee 0x22cd 0xa3c1 0xfb4 0xbdd 0x24bc 0xa345 0xf9c 0xbca 0x26ab 0xa2cf 0xf93 0xbc3 0x289a 0xa25c 0xf94 0xbc3 0x2a89 0xa1e8 0xf8b 0xbbf 0x2c78 0xa172 0xf7b 0xbb1 0x2e67 0xa104 0xf84 0xbb8 0x3056 0xa08d 0xf79 0xbb0 0x3245 0xa01a 0xf78 0xbaf 0x3434 0x9fac 0xf6e 0xba8 0x3623 0x9f3f 0xf6b 0xba5 0x3812 0x9ed2 0xf70 0xba9 0x3a01 0x9e62 0xf7b 0xbb1 0x3bf0 0x9ded 0xf82 0xbb7 0x3ddf 0x9d70 0xf72 0xbab 0x3fce 0x9ced 0xf41 0xb86 0x41bc 0x9c6f 0xf10 0xb61 0x43ab 0x9bf2 0xee1 0xb3d 0x459a 0x9b79 0xe9f 0xb0b 0x4789 0x9b01 0xe56 0xad4 0x4978 0x9a8c 0xe18 0xaa6 0x4b67 0x9a19 0xde8 0xa81 0x4d56 0x99a7 0xdb9 0xa5d 0x4f45 0x993a 0xd94 0xa42 0x5134 0x98d9 0xd7d 0xa30 0x5323 0x9877 0xd65 0xa1f 0x5512 0x9821 0xd57 0xa14 0x5701 0x97cf 0xd4a 0xa0a 0x58f0 0x9780 0xd43 0xa04 0x5adf 0x9735 0xd3f 0xa02 0x5cce 0x96f0 0xd3a 0x9fd 0x5ebd 0x96ae 0xd43 0xa04 0x60ac 0x966d 0xd45 0xa05 0x629b 0x9636 0xd5a 0xa17 0x648a 0x95fb 0xd73 0xa29 0x6679 0x95c6 0xd7b 0xa2f 0x6868 0x9592 0xd81 0xa34 0x6a57 0x955e 0xd92 0xa41 0x6c45 0x952d 0xda7 0xa50 0x6e34 0x94fc 0xdb4 0xa5a 0x7023 0x94d1 0xdcd 0xa6e 0x7212 0x94a5 0xdda 0xa76 0x7401 0x947e 0xdef 0xa86 0x75f0 0x9458 0xdfe 0xa92 0x77df 0x9432 0xe11 0xaa1 0x79ce 0x940e 0xe2a 0xab3 0x7bbd 0x93ed 0xe3f 0xac3 0x7dac 0x93cd 0xe4d 0xacd 0x7f9b 0x93ab 0xe63 0xade 0x818a 0x9390 0xe70 0xae8 0x8379 0x937a 0xe92 0xb01 0x8568 0x9368 0xec8 0xb2a 0x8757 0x9351 0xeef 0xb48 0x8946 0x9336 0xf16 0xb65 0x8b35 0x931b 0xf53 0xb93 0x8d24 0x92ff 0xf91 0xbc2 0x8f13 0x92de 0xfd9 0xbf9 0x9102 0x92b7 0x1021 0xc2f 0x92f1 0x928d 0x1080 0xc76 0x94e0 0x925d 0x10f2 0xccd 0x96ce 0x922c 0x116b 0xd29 0x98bd 0x91f3 0x11ea 0xd89 0x9aac 0x91b2 0x127a 0xdf6 0x9c9b 0x916f 0x1326 0xe77 0x9e8a 0x9129 0x13dd 0xf01 0xa079 0x90dc 0x14a9 0xf9c 0xa268 0x9095 0x1576 0x1036 0xa457 0x904e 0x166a 0x10ef 0xa646 0x900e 0x1777 0x11ba 0xa835 0x8fdd 0x18ab 0x12a3 0xaa24 0x8fb9 0x1a18 0x13b7 0xac13 0x8f92 0x1bc4 0x14fa 0xae02 0x8f54 0x1db4 0x1671 0xaff1 0x8efc 0x2027 0x184a 0xb1e0 0x8e6c 0x231a 0x1a85 0xb3cf 0x8d50 0x266b 0x1d06 0xb5be 0x8b7d 0x2aef 0x2070 0xb7ad 0x88d8 0x31af 0x258a 0xb99c 0x86fa 0x3cad 0x2dd6 0xbb8b 0x86fa 0x4176 0x3173 0xbd7a 0x86fa 0x4176 0x3173 0xbf69 0x86fa 0x4176 0x3173>;
			battery0_profile_t3_col = <0x4>;
			battery0_profile_t3_num = <0x64>;
			battery0_profile_t4 = <0x0 0xac85 0x2418 0x1f33 0x1ef 0xabc6 0x2418 0x1f32 0x3de 0xab24 0x248a 0x1f95 0x5cd 0xaa89 0x24bf 0x1fc3 0x7bc 0xa9f1 0x24b4 0x1fba 0x9ab 0xa95b 0x2480 0x1f8c 0xb9a 0xa8cb 0x2454 0x1f66 0xd89 0xa841 0x242e 0x1f46 0xf78 0xa7af 0x22ed 0x1e31 0x1167 0xa721 0x23a3 0x1ecd 0x1356 0xa698 0x238c 0x1eba 0x1545 0xa641 0x23b6 0x1ede 0x1733 0xa5dc 0x1fa1 0x1b57 0x1922 0xa557 0x1e0d 0x19fa 0x1b11 0xa4ca 0x20d7 0x1c63 0x1d00 0xa448 0x2101 0x1c87 0x1eef 0xa3c5 0x20dc 0x1c67 0x20de 0xa347 0x20ab 0x1c3d 0x22cd 0xa2c5 0x206e 0x1c08 0x24bc 0xa24b 0x2045 0x1be4 0x26ab 0xa1d4 0x200a 0x1bb1 0x289a 0xa15c 0x1fd9 0x1b87 0x2a89 0xa0e4 0x1fca 0x1b7a 0x2c78 0xa06d 0x1fc9 0x1b79 0x2e67 0x9ffc 0x1fbb 0x1b6d 0x3056 0x9f8f 0x1f96 0x1b4d 0x3245 0x9f22 0x1f94 0x1b4c 0x3434 0x9eac 0x1f94 0x1b4c 0x3623 0x9e28 0x1f7b 0x1b36 0x3812 0x9da0 0x1f49 0x1b0b 0x3a01 0x9d18 0x1f12 0x1adb 0x3bf0 0x9c91 0x1ee1 0x1ab1 0x3ddf 0x9c10 0x1eba 0x1a8f 0x3fce 0x9b98 0x1ed3 0x1aa5 0x41bc 0x9b2b 0x1eb1 0x1a87 0x43ab 0x9acc 0x1c23 0x1852 0x459a 0x9a7f 0x1dee 0x19df 0x4789 0x9a16 0x1def 0x19df 0x4978 0x999a 0x1d9b 0x1997 0x4b67 0x992b 0x1fba 0x1b6d 0x4d56 0x98c4 0x1fff 0x1ba8 0x4f45 0x985c 0x1ff5 0x1b9f 0x5134 0x980b 0x203d 0x1bde 0x5323 0x97b0 0x2066 0x1c01 0x5512 0x9767 0x1778 0x1448 0x5701 0x9715 0x1a4b 0x16bb 0x58f0 0x96be 0x2150 0x1ccb 0x5adf 0x9672 0x21ce 0x1d38 0x5cce 0x9630 0x2203 0x1d66 0x5ebd 0x95e9 0x221f 0x1d7e 0x60ac 0x95ad 0x228c 0x1ddd 0x629b 0x9572 0x22d9 0x1e1f 0x648a 0x9535 0x2317 0x1e55 0x6679 0x9504 0x235b 0x1e90 0x6868 0x94d8 0x23b0 0x1ed9 0x6a57 0x94ad 0x2408 0x1f25 0x6c45 0x9485 0x2457 0x1f69 0x6e34 0x946a 0x24b7 0x1fbc 0x7023 0x944f 0x2524 0x201b 0x7212 0x9433 0x25a7 0x208c 0x7401 0x941c 0x262c 0x20fe 0x75f0 0x9406 0x26c9 0x2186 0x77df 0x93f0 0x2772 0x2219 0x79ce 0x93dd 0x2820 0x22af 0x7bbd 0x93ca 0x28d6 0x234c 0x7dac 0x93b0 0x2989 0x23e7 0x7f9b 0x939a 0x2a33 0x247a 0x818a 0x9384 0x2b15 0x253d 0x8379 0x9369 0x2c05 0x260c 0x8568 0x934a 0x2cf8 0x26de 0x8757 0x932d 0x2dfe 0x27c1 0x8946 0x9312 0x2f22 0x28bd 0x8b35 0x92f3 0x3051 0x29c3 0x8d24 0x92d0 0x3153 0x2aa2 0x8f13 0x92c0 0x31e4 0x2b1f 0x9102 0x928e 0x31e4 0x2b1f 0x92f1 0x9262 0x3371 0x2c77 0x94e0 0x9232 0x348c 0x2d6c 0x96ce 0x9205 0x3549 0x2e0f 0x98bd 0x91d7 0x35e8 0x2e98 0x9aac 0x91a4 0x3672 0x2f10 0x9c9b 0x916c 0x36eb 0x2f78 0x9e8a 0x9131 0x3762 0x2fdf 0xa079 0x90f5 0x37aa 0x301d 0xa268 0x90b8 0x3807 0x306e 0xa457 0x9079 0x388d 0x30e1 0xa646 0x903b 0x3943 0x317f 0xa835 0x8fff 0x39e8 0x320e 0xaa24 0x8fcb 0x3a87 0x3297 0xac13 0x8fa4 0x3b76 0x3365 0xae02 0x8f7e 0x3c94 0x345d 0xaff1 0x8f58 0x3e15 0x35aa 0xb1e0 0x8f1d 0x3fe7 0x373c 0xb3cf 0x8ebf 0x426a 0x3968 0xb5be 0x8e02 0x45aa 0x3c37 0xb7ad 0x8d91 0x4c42 0x41ec 0xb99c 0x8d91 0x5013 0x4536 0xbb8b 0x8d91 0x5013 0x4536 0xbd7a 0x8d91 0x5013 0x4536 0xbf69 0x8d91 0x5013 0x4536>;
			battery0_profile_t4_col = <0x4>;
			battery0_profile_t4_num = <0x64>;
			battery1_profile_t0 = <0x0 0xace2 0x3b6 0x387 0x1fd 0xac72 0x3b7 0x386 0x3fa 0xac06 0x3ac 0x393 0x5f8 0xaba5 0x3b3 0x395 0x7f5 0xab45 0x3b7 0x398 0x9f2 0xaae6 0x3b7 0x3a1 0xbef 0xaa84 0x3bd 0x3a7 0xded 0xaa1c 0x3bf 0x3a7 0xfea 0xa9b2 0x3b9 0x3a7 0x11e7 0xa948 0x3c6 0x3a8 0x13e4 0xa8dc 0x3d1 0x3af 0x15e1 0xa867 0x3c5 0x3a8 0x17df 0xa7f0 0x3c4 0x3a2 0x19dc 0xa776 0x3ba 0x3ac 0x1bd9 0xa6ff 0x3c0 0x3b3 0x1dd6 0xa685 0x3c4 0x3b1 0x1fd3 0xa607 0x3be 0x3b0 0x21d1 0xa588 0x3b6 0x3b1 0x23ce 0xa50c 0x3b9 0x3b3 0x25cb 0xa492 0x3c7 0x3b2 0x27c8 0xa41c 0x3d2 0x3bc 0x29c6 0xa3a0 0x3d2 0x3ba 0x2bc3 0xa325 0x3d2 0x3c2 0x2dc0 0xa2aa 0x3d4 0x3c3 0x2fbd 0xa22e 0x3c9 0x3c7 0x31ba 0xa1b6 0x3cd 0x3c9 0x33b8 0xa141 0x3d2 0x3c9 0x35b5 0xa0ce 0x3d9 0x3cc 0x37b2 0xa05b 0x3e1 0x3d2 0x39af 0x9fe9 0x3e5 0x3d9 0x3bad 0x9f7e 0x3ef 0x3e1 0x3daa 0x9f13 0x3ef 0x3dc 0x3fa7 0x9ea2 0x3ef 0x3dc 0x41a4 0x9e37 0x3ef 0x3f8 0x43a1 0x9dd1 0x403 0x3fd 0x459f 0x9d68 0x400 0x3fc 0x479c 0x9d05 0x40c 0x40c 0x4999 0x9ca6 0x425 0x41e 0x4b96 0x9c46 0x433 0x42f 0x4d93 0x9be6 0x436 0x43f 0x4f91 0x9b89 0x44a 0x444 0x518e 0x9b2e 0x46e 0x43b 0x538b 0x9ac7 0x485 0x3e8 0x5588 0x9a30 0x453 0x3b8 0x5786 0x9975 0x3e7 0x3b6 0x5983 0x98f1 0x3c8 0x3b1 0x5b80 0x988f 0x3bc 0x3b0 0x5d7d 0x9839 0x3b7 0x3af 0x5f7a 0x97ea 0x3b7 0x3ae 0x6178 0x97a3 0x3b7 0x3ae 0x6375 0x9760 0x3b7 0x3b0 0x6572 0x971d 0x3b7 0x3b0 0x676f 0x96df 0x3b7 0x3af 0x696d 0x96a2 0x3b7 0x3aa 0x6b6a 0x966a 0x3b7 0x3b4 0x6d67 0x9632 0x3b7 0x3b6 0x6f64 0x95fe 0x3b7 0x3b5 0x7161 0x95ce 0x3bf 0x3b9 0x735f 0x959b 0x3c4 0x3bc 0x755c 0x9568 0x3c4 0x3bb 0x7759 0x953d 0x3cd 0x3bf 0x7956 0x9513 0x3d9 0x3cc 0x7b53 0x94e4 0x3c6 0x3d6 0x7d51 0x94c1 0x3d2 0x3d6 0x7f4e 0x949a 0x3de 0x3dc 0x814b 0x9473 0x3e1 0x3ee 0x8348 0x9450 0x3e0 0x3eb 0x8546 0x942e 0x3e9 0x3f6 0x8743 0x9410 0x405 0x3e8 0x8940 0x93e9 0x40b 0x3c1 0x8b3d 0x93ab 0x3e9 0x3a7 0x8d3a 0x935b 0x3bf 0x3ab 0x8f38 0x930b 0x3ae 0x3b3 0x9135 0x92ce 0x3c4 0x3ae 0x9332 0x92a2 0x3c4 0x3b6 0x952f 0x9275 0x3c4 0x3b6 0x972d 0x923e 0x3c4 0x3bb 0x992a 0x920e 0x3ba 0x3bc 0x9b27 0x91e5 0x3c6 0x3c4 0x9d24 0x91be 0x3d3 0x3cc 0x9f21 0x9197 0x3d9 0x3c8 0xa11f 0x9169 0x3e3 0x3bc 0xa31c 0x912d 0x3e7 0x3bd 0xa519 0x90e6 0x3d2 0x3c9 0xa716 0x90a2 0x3c5 0x3c6 0xa913 0x9064 0x3d1 0x39d 0xab11 0x900d 0x3bb 0x3a0 0xad0e 0x8fd3 0x3a2 0x3ba 0xaf0b 0x8fbd 0x3a4 0x3d3 0xb108 0x8fb2 0x3c7 0x3fd 0xb306 0x8fa6 0x3f3 0x43b 0xb503 0x8f97 0x423 0x449 0xb700 0x8f78 0x461 0x40b 0xb8fd 0x8f20 0x47b 0x3f2 0xbafa 0x8e1b 0x408 0x416 0xbcf8 0x8c49 0x3fc 0x451 0xbef5 0x89e1 0x42e 0x525 0xc0f2 0x8685 0x46b 0x29ec 0xc2ef 0x8118 0x572 0x3338 0xc4ed 0x7f26 0x3036 0x3338>;
			battery1_profile_t0_col = <0x4>;
			battery1_profile_t0_num = <0x64>;
			battery1_profile_t1 = <0x0 0xac85 0x492 0x44e 0x1fd 0xac26 0x495 0x44c 0x3fa 0xabd0 0x4ab 0x44c 0x5f8 0xab73 0x4a5 0x455 0x7f5 0xab13 0x4aa 0x459 0x9f2 0xaab3 0x4af 0x452 0xbef 0xaa51 0x4b5 0x44c 0xded 0xa9e7 0x4b4 0x450 0xfea 0xa978 0x4a6 0x459 0x11e7 0xa90c 0x4b2 0x459 0x13e4 0xa89b 0x4bc 0x457 0x15e1 0xa81f 0x4ae 0x44a 0x17df 0xa7a8 0x4ba 0x44c 0x19dc 0xa72e 0x4bd 0x44c 0x1bd9 0xa6b2 0x4c5 0x455 0x1dd6 0xa632 0x4c2 0x460 0x1fd3 0xa5b4 0x4bc 0x465 0x21d1 0xa538 0x4bc 0x466 0x23ce 0xa4bd 0x4c2 0x467 0x25cb 0xa440 0x4c7 0x465 0x27c8 0xa3c0 0x4bf 0x463 0x29c6 0xa34a 0x4cb 0x459 0x2bc3 0xa2d4 0x4d8 0x465 0x2dc0 0xa258 0x4d8 0x465 0x2fbd 0xa1e1 0x4e2 0x479 0x31ba 0xa16b 0x4e5 0x489 0x33b8 0xa0f5 0x4df 0x486 0x35b5 0xa07e 0x4d9 0x47a 0x37b2 0xa00d 0x4e4 0x474 0x39af 0x9fa1 0x4f5 0x47c 0x3bad 0x9f32 0x4f8 0x491 0x3daa 0x9ec8 0x506 0x49c 0x3fa7 0x9e62 0x51c 0x49a 0x41a4 0x9df1 0x504 0x49a 0x43a1 0x9d8b 0x524 0x4b1 0x459f 0x9d22 0x536 0x4bf 0x479c 0x9cb7 0x543 0x4ca 0x4999 0x9c53 0x556 0x4dd 0x4b96 0x9bf9 0x56e 0x4ee 0x4d93 0x9b9e 0x582 0x4ff 0x4f91 0x9b36 0x58c 0x510 0x518e 0x9abc 0x57c 0x506 0x538b 0x9a1d 0x52d 0x4d0 0x5588 0x9974 0x4cb 0x465 0x5786 0x98f9 0x4b2 0x443 0x5983 0x9896 0x498 0x43d 0x5b80 0x9845 0x49e 0x43d 0x5d7d 0x97f6 0x490 0x42f 0x5f7a 0x97ae 0x48d 0x432 0x6178 0x976a 0x48d 0x432 0x6375 0x9729 0x48a 0x42d 0x6572 0x96ec 0x490 0x43c 0x676f 0x96af 0x488 0x433 0x696d 0x9677 0x492 0x433 0x6b6a 0x963f 0x486 0x43f 0x6d67 0x960c 0x492 0x43f 0x6f64 0x95de 0x49e 0x43f 0x7161 0x95ac 0x4a0 0x447 0x735f 0x957e 0x4b2 0x44b 0x755c 0x9554 0x4c3 0x459 0x7759 0x952a 0x4c9 0x46b 0x7956 0x94ff 0x4cf 0x473 0x7b53 0x94d8 0x4db 0x478 0x7d51 0x94b7 0x4e5 0x48d 0x7f4e 0x9495 0x4e5 0x48d 0x814b 0x946e 0x4db 0x48d 0x8348 0x944b 0x4e4 0x48d 0x8546 0x942e 0x4f0 0x4a1 0x8743 0x940e 0x4f3 0x4a7 0x8940 0x93e5 0x4e4 0x498 0x8b3d 0x93b6 0x4d3 0x481 0x8d3a 0x9383 0x4c5 0x46f 0x8f38 0x9352 0x4b9 0x45f 0x9135 0x9326 0x4b4 0x451 0x9332 0x92fe 0x4c9 0x465 0x952f 0x92d0 0x4bb 0x467 0x972d 0x929f 0x4b1 0x45a 0x992a 0x927b 0x4b9 0x46e 0x9b27 0x925e 0x4d1 0x472 0x9d24 0x923a 0x4d8 0x47c 0x9f21 0x9208 0x4d8 0x479 0xa11f 0x91c9 0x4d8 0x474 0xa31c 0x9188 0x4d3 0x46e 0xa519 0x914a 0x4cf 0x470 0xa716 0x9109 0x4db 0x489 0xa913 0x90b9 0x4e1 0x47f 0xab11 0x9066 0x4bb 0x474 0xad0e 0x904a 0x4bb 0x466 0xaf0b 0x903d 0x4c8 0x465 0xb108 0x9031 0x4e8 0x479 0xb306 0x9022 0x505 0x487 0xb503 0x900e 0x52e 0x4a2 0xb700 0x8fdb 0x566 0x4d3 0xb8fd 0x8f23 0x562 0x4da 0xbafa 0x8d92 0x524 0x4ae 0xbcf8 0x8b55 0x541 0x4c7 0xbef5 0x8853 0x57c 0x4f1 0xc0f2 0x83e2 0x605 0x551 0xc2ef 0x7828 0x188e 0x85e 0xc4ed 0x76de 0x1e14 0x656>;
			battery1_profile_t1_col = <0x4>;
			battery1_profile_t1_num = <0x64>;
			battery1_profile_t2 = <0x0 0xacbd 0x6b8 0x5af 0x1fd 0xac51 0x6ba 0x5af 0x3fa 0xabef 0x701 0x5af 0x5f8 0xab8e 0x70d 0x5af 0x7f5 0xab35 0x65c 0x5af 0x9f2 0xaad9 0x67a 0x5af 0xbef 0xaa75 0x6ec 0x5af 0xded 0xaa0b 0x701 0x5af 0xfea 0xa99f 0x6bc 0x5af 0x11e7 0xa92f 0x676 0x5af 0x13e4 0xa8b6 0x6d0 0x5af 0x15e1 0xa83a 0x6de 0x5af 0x17df 0xa7c2 0x641 0x5af 0x19dc 0xa74a 0x657 0x5af 0x1bd9 0xa6c8 0x6b9 0x5af 0x1dd6 0xa644 0x6dd 0x5af 0x1fd3 0xa5ca 0x646 0x5af 0x21d1 0xa54a 0x642 0x5af 0x23ce 0xa4ca 0x6ab 0x5af 0x25cb 0xa44a 0x6ea 0x5af 0x27c8 0xa3cc 0x69a 0x5af 0x29c6 0xa356 0x64b 0x5dc 0x2bc3 0xa2e1 0x6d7 0x64e 0x2dc0 0xa264 0x6fa 0x66e 0x2fbd 0xa1e6 0x691 0x60d 0x31ba 0xa16f 0x69f 0x61b 0x33b8 0xa0f7 0x702 0x675 0x35b5 0xa080 0x72f 0x69f 0x37b2 0xa011 0x689 0x605 0x39af 0x9fa1 0x6b2 0x62b 0x3bad 0x9f36 0x72c 0x69c 0x3daa 0x9ecc 0x77b 0x6e4 0x3fa7 0x9e62 0x734 0x6a2 0x41a4 0x9df5 0x6ef 0x664 0x43a1 0x9d7e 0x783 0x6ec 0x459f 0x9d08 0x7a8 0x70e 0x479c 0x9c9c 0x743 0x6b1 0x4999 0x9c30 0x739 0x6a7 0x4b96 0x9bc9 0x791 0x6f9 0x4d93 0x9b5d 0x7b9 0x71d 0x4f91 0x9aff 0x729 0x69a 0x518e 0x9a74 0x6ec 0x661 0x538b 0x99d6 0x6c2 0x63b 0x5588 0x9948 0x69f 0x61a 0x5786 0x98cd 0x607 0x58e 0x5983 0x9867 0x5a6 0x534 0x5b80 0x9811 0x616 0x59c 0x5d7d 0x97c1 0x621 0x5a6 0x5f7a 0x9780 0x637 0x5ba 0x6178 0x9737 0x5b9 0x546 0x6375 0x96f9 0x613 0x59a 0x6572 0x96b4 0x608 0x58f 0x676f 0x967e 0x63e 0x5c0 0x696d 0x9646 0x64b 0x5cd 0x6b6a 0x960d 0x63a 0x5bd 0x6d67 0x95dc 0x630 0x5b4 0x6f64 0x95ab 0x630 0x5b4 0x7161 0x957a 0x636 0x5b9 0x735f 0x954d 0x63f 0x5c1 0x755c 0x9521 0x639 0x5bc 0x7759 0x94f9 0x61f 0x5a3 0x7956 0x94d1 0x610 0x596 0x7b53 0x94aa 0x65b 0x5dc 0x7d51 0x9487 0x680 0x5fe 0x7f4e 0x946a 0x602 0x589 0x814b 0x9449 0x5f6 0x57f 0x8348 0x9427 0x64f 0x5d0 0x8546 0x9405 0x67f 0x5fd 0x8743 0x93ec 0x63b 0x5be 0x8940 0x93d2 0x606 0x58d 0x8b3d 0x93ae 0x62f 0x5b3 0x8d3a 0x9386 0x656 0x5d7 0x8f38 0x935f 0x62f 0x5b3 0x9135 0x933c 0x5c7 0x553 0x9332 0x930e 0x5e3 0x56c 0x952f 0x92e1 0x63d 0x5bf 0x972d 0x92ad 0x61b 0x5a0 0x992a 0x9284 0x5a7 0x536 0x9b27 0x926a 0x5d1 0x55d 0x9d24 0x9243 0x63c 0x5bf 0x9f21 0x91f9 0x63a 0x5bc 0xa11f 0x91b0 0x5da 0x564 0xa31c 0x917e 0x5ca 0x556 0xa519 0x9148 0x638 0x5bb 0xa716 0x90f0 0x66d 0x5ec 0xa913 0x908b 0x60f 0x596 0xab11 0x9066 0x5b0 0x53e 0xad0e 0x9060 0x616 0x59c 0xaf0b 0x904f 0x69f 0x61a 0xb108 0x9029 0x689 0x605 0xb306 0x901d 0x63a 0x5be 0xb503 0x9003 0x68a 0x606 0xb700 0x8f79 0x714 0x686 0xb8fd 0x8e07 0x735 0x6a3 0xbafa 0x8bcb 0x702 0x675 0xbcf8 0x88d0 0x73b 0x6a9 0xbef5 0x8413 0x93c 0x885 0xc0f2 0x7e51 0x1d85 0x1b38 0xc2ef 0x7e54 0x2e64 0x2ac0 0xc4ed 0x7e54 0x2e64 0x2ac0>;
			battery1_profile_t2_col = <0x4>;
			battery1_profile_t2_num = <0x64>;
			battery1_profile_t3 = <0x0 0xac34 0xa3c 0x8b7 0x1fd 0xabc4 0xa3a 0x8b7 0x3fa 0xab5e 0xa51 0x8b7 0x5f8 0xab06 0xa60 0x8b7 0x7f5 0xaaa6 0xa4a 0x8b7 0x9f2 0xaa45 0xa3a 0x8b7 0xbef 0xa9e0 0xa2e 0x8b7 0xded 0xa975 0xa1f 0x8b7 0xfea 0xa907 0xa18 0x8b7 0x11e7 0xa891 0x9fe 0x8b7 0x13e4 0xa815 0x9e5 0x8b7 0x15e1 0xa79f 0x9e7 0x8b7 0x17df 0xa724 0x9dc 0x8b7 0x19dc 0xa6a8 0x9e3 0x8b7 0x1bd9 0xa62d 0x9de 0x8b7 0x1dd6 0xa5b2 0x9da 0x8b7 0x1fd3 0xa536 0x9d3 0x8b7 0x21d1 0xa4b8 0x9c6 0x8b7 0x23ce 0xa439 0x9bf 0x8b7 0x25cb 0xa3bd 0x9bd 0x8b7 0x27c8 0xa343 0x9c0 0x8b7 0x29c6 0xa2cd 0x9da 0x8b7 0x2bc3 0xa257 0x9d8 0x8b7 0x2dc0 0xa1e1 0x9e5 0x90e 0x2fbd 0xa167 0x9e8 0x921 0x31ba 0xa0f3 0x9f0 0x928 0x33b8 0xa07c 0x9f5 0x92c 0x35b5 0xa003 0x9f5 0x92c 0x37b2 0x9f91 0xa03 0x93a 0x39af 0x9f28 0xa21 0x955 0x3bad 0x9ec3 0xa31 0x964 0x3daa 0x9e57 0xa48 0x97a 0x3fa7 0x9de1 0xa56 0x987 0x41a4 0x9d66 0xa55 0x985 0x43a1 0x9cea 0xa61 0x990 0x459f 0x9c73 0xa5b 0x98a 0x479c 0x9bf9 0xa3e 0x96f 0x4999 0x9b81 0xa1e 0x952 0x4b96 0x9b09 0x9f4 0x92c 0x4d93 0x9a8d 0x9bb 0x8f7 0x4f91 0x9a11 0x985 0x8c6 0x518e 0x9998 0x94b 0x890 0x538b 0x9928 0x924 0x86c 0x5588 0x98b7 0x8e6 0x833 0x5786 0x9851 0x8b3 0x804 0x5983 0x97f5 0x8a0 0x7f2 0x5b80 0x97a0 0x88b 0x7e0 0x5d7d 0x9756 0x889 0x7de 0x5f7a 0x9710 0x889 0x7de 0x6178 0x96c9 0x882 0x7d7 0x6375 0x9689 0x885 0x7da 0x6572 0x9650 0x88f 0x7e4 0x676f 0x9613 0x891 0x7e6 0x696d 0x95e1 0x8ac 0x7fe 0x6b6a 0x95a9 0x8a0 0x7f3 0x6d67 0x9575 0x8a9 0x7fb 0x6f64 0x954b 0x8bd 0x80d 0x7161 0x951d 0x8be 0x80e 0x735f 0x94ed 0x8c0 0x810 0x755c 0x94c0 0x8c6 0x815 0x7759 0x9497 0x8d2 0x821 0x7956 0x9474 0x8ef 0x83c 0x7b53 0x944d 0x8f1 0x83d 0x7d51 0x9426 0x8f0 0x83c 0x7f4e 0x940a 0x908 0x852 0x814b 0x93ee 0x909 0x854 0x8348 0x93cd 0x915 0x85f 0x8546 0x93af 0x919 0x862 0x8743 0x9397 0x920 0x869 0x8940 0x9381 0x92e 0x875 0x8b3d 0x9368 0x936 0x87d 0x8d3a 0x934e 0x93a 0x880 0x8f38 0x9337 0x943 0x889 0x9135 0x9320 0x944 0x88a 0x9332 0x9304 0x950 0x895 0x952f 0x92dd 0x95d 0x8a1 0x972d 0x92b5 0x95e 0x8a2 0x992a 0x928e 0x972 0x8b5 0x9b27 0x9263 0x982 0x8c3 0x9d24 0x9233 0x99c 0x8db 0x9f21 0x91f8 0x9b6 0x8f2 0xa11f 0x91b3 0x9cc 0x907 0xa31c 0x916e 0x9f8 0x930 0xa519 0x9133 0xa37 0x96a 0xa716 0x90e9 0xa73 0x9a2 0xa913 0x9089 0xa98 0x9c3 0xab11 0x904a 0xad5 0x9fb 0xad0e 0x9025 0xb29 0xa4a 0xaf0b 0x9007 0xb8b 0xaa3 0xb108 0x8fef 0xc16 0xb23 0xb306 0x8fd5 0xce0 0xbdd 0xb503 0x8fad 0xdfd 0xce4 0xb700 0x8f50 0xf87 0xe4f 0xb8fd 0x8e68 0x1187 0x1027 0xbafa 0x8c88 0x144d 0x12b7 0xbcf8 0x89e7 0x1a76 0x1863 0xbef5 0x8611 0x2c40 0x28ca 0xc0f2 0x85b6 0x3ecc 0x39de 0xc2ef 0x85b6 0x3ecc 0x39de 0xc4ed 0x85b6 0x3ecc 0x39de>;
			battery1_profile_t3_col = <0x4>;
			battery1_profile_t3_num = <0x64>;
			battery1_profile_t4 = <0x0 0xac91 0x14b4 0x1213 0x1fd 0xac05 0x14b8 0x1217 0x3fa 0xab88 0x14b8 0x1217 0x5f8 0xab23 0x14c4 0x1220 0x7f5 0xaabc 0x14b6 0x1215 0x9f2 0xaa51 0x1495 0x11f8 0xbef 0xa9e6 0x147b 0x11e1 0xded 0xa979 0x143d 0x11aa 0xfea 0xa909 0x13ec 0x1164 0x11e7 0xa898 0x1445 0x11b3 0x13e4 0xa823 0x142e 0x119e 0x15e1 0xa7b8 0x1422 0x1193 0x17df 0xa74e 0xfe0 0xddd 0x19dc 0xa6d1 0x1204 0xfba 0x1bd9 0xa64f 0x12e4 0x107e 0x1dd6 0xa5d2 0x12dd 0x1078 0x1fd3 0xa554 0x12cb 0x1068 0x21d1 0xa4d5 0x12b1 0x1052 0x23ce 0xa45a 0x1299 0x103c 0x25cb 0xa3df 0x127c 0x1023 0x27c8 0xa369 0x1259 0x1004 0x29c6 0xa2ee 0x124f 0xffb 0x2bc3 0xa277 0x1259 0x1004 0x2dc0 0xa202 0x1271 0x101a 0x2fbd 0xa188 0x1264 0x100e 0x31ba 0xa114 0x126d 0x1016 0x33b8 0xa09a 0x1268 0x1011 0x35b5 0xa01e 0x125a 0x1005 0x37b2 0x9fab 0x125f 0x100a 0x39af 0x9f3a 0x126d 0x1016 0x3bad 0x9eca 0x127c 0x1023 0x3daa 0x9e59 0x129f 0x1042 0x3fa7 0x9ddd 0x12ab 0x104c 0x41a4 0x9d58 0x12a2 0x1044 0x43a1 0x9cd1 0x117a 0xf42 0x459f 0x9c4f 0x1244 0xff2 0x479c 0x9bbf 0x119b 0xf5e 0x4999 0x9b31 0x119b 0xf5f 0x4b96 0x9aaf 0x12a5 0x1046 0x4d93 0x9a37 0x12a2 0x1044 0x4f91 0x99c8 0x1284 0x102a 0x518e 0x995e 0x1284 0x102a 0x538b 0x98f3 0x1282 0x1028 0x5588 0x98a4 0xce9 0xb46 0x5786 0x983c 0x1183 0xf4a 0x5983 0x97e3 0x1312 0x10a6 0x5b80 0x978f 0x133e 0x10cc 0x5d7d 0x973f 0x134b 0x10d8 0x5f7a 0x96f6 0x136b 0x10f3 0x6178 0x96b0 0x1394 0x1118 0x6375 0x9669 0x13aa 0x112a 0x6572 0x9627 0x13bc 0x113b 0x676f 0x95ef 0x13f9 0x116f 0x696d 0x95b1 0x1413 0x1186 0x6b6a 0x957e 0x144f 0x11bb 0x6d67 0x9547 0x146d 0x11d5 0x6f64 0x9513 0x1485 0x11ea 0x7161 0x94e1 0x14af 0x120f 0x735f 0x94b4 0x14e8 0x1240 0x755c 0x948d 0x1520 0x1271 0x7759 0x9464 0x1552 0x129d 0x7956 0x9439 0x157f 0x12c4 0x7b53 0x9417 0x159a 0x12dc 0x7d51 0x93f6 0x15cc 0x1307 0x7f4e 0x93df 0x15fe 0x1333 0x814b 0x93c4 0x1619 0x134a 0x8348 0x93b0 0x1650 0x137a 0x8546 0x939c 0x1687 0x13aa 0x8743 0x9389 0x16c7 0x13e3 0x8940 0x9378 0x1716 0x1427 0x8b3d 0x9363 0x1769 0x146f 0x8d3a 0x934b 0x17ab 0x14a9 0x8f38 0x933e 0x17b9 0x14b6 0x9135 0x9321 0x175d 0x1466 0x9332 0x9300 0x1862 0x154a 0x952f 0x92de 0x18f3 0x15c8 0x972d 0x92bc 0x1985 0x1647 0x992a 0x9292 0x1a12 0x16c2 0x9b27 0x9262 0x1aac 0x1749 0x9d24 0x922f 0x1b62 0x17e8 0x9f21 0x91f8 0x1c29 0x1896 0xa11f 0x91ba 0x1cf8 0x194a 0xa31c 0x917c 0x1dde 0x1a13 0xa519 0x9137 0x1edc 0x1af1 0xa716 0x90e8 0x2014 0x1c01 0xa913 0x90a0 0x2159 0x1d1e 0xab11 0x9056 0x22bd 0x1e54 0xad0e 0x901b 0x246b 0x1fcc 0xaf0b 0x8fe6 0x2693 0x21ad 0xb108 0x8fbe 0x295d 0x241d 0xb306 0x8f97 0x2ce6 0x2733 0xb503 0x8f6a 0x316f 0x2b29 0xb700 0x8f30 0x3764 0x305d 0xb8fd 0x8ec0 0x3f09 0x370b 0xbafa 0x8e00 0x4860 0x3f32 0xbcf8 0x8dfe 0x5133 0x46e3 0xbef5 0x8dfe 0x5133 0x46e3 0xc0f2 0x8dfe 0x5133 0x46e3 0xc2ef 0x8dfe 0x5133 0x46e3 0xc4ed 0x8dfe 0x5133 0x46e3>;
			battery1_profile_t4_col = <0x4>;
			battery1_profile_t4_num = <0x64>;
			battery2_profile_t0 = <0x0 0xac60 0x3b6 0x387 0x1fb 0xabe7 0x3b5 0x386 0x3f6 0xab79 0x3c3 0x393 0x5f1 0xab0c 0x3c5 0x395 0x7ec 0xaaa1 0x3c9 0x398 0x9e6 0xaa37 0x3d2 0x3a1 0xbe1 0xa9cb 0x3d8 0x3a7 0xddc 0xa95c 0x3d8 0x3a7 0xfd7 0xa8ea 0x3d8 0x3a7 0x11d2 0xa879 0x3da 0x3a8 0x13cd 0xa804 0x3e1 0x3af 0x15c8 0xa78b 0x3d9 0x3a8 0x17c3 0xa711 0x3d3 0x3a2 0x19be 0xa69a 0x3dd 0x3ac 0x1bb8 0xa621 0x3e4 0x3b2 0x1db3 0xa5a4 0x3e3 0x3b2 0x1fae 0xa529 0x3e1 0x3b0 0x21a9 0xa4b1 0x3e3 0x3b1 0x23a4 0xa437 0x3e5 0x3b3 0x259f 0xa3bb 0x3e3 0x3b1 0x279a 0xa345 0x3ef 0x3bc 0x2995 0xa2cf 0x3ed 0x3ba 0x2b8f 0xa25a 0x3f4 0x3c1 0x2d8a 0xa1e4 0x3f5 0x3c3 0x2f85 0xa173 0x3fa 0x3c7 0x3180 0xa100 0x3fc 0x3c9 0x337b 0xa08d 0x3fc 0x3c9 0x3576 0xa01e 0x3fe 0x3cb 0x3771 0x9fb1 0x404 0x3d1 0x396c 0x9f45 0x40c 0x3d8 0x3b67 0x9edd 0x416 0x3e2 0x3d61 0x9e73 0x410 0x3dc 0x3f5c 0x9e0e 0x410 0x3dc 0x4157 0x9dae 0x42a 0x3f4 0x4352 0x9d4b 0x433 0x3fd 0x454d 0x9cea 0x432 0x3fd 0x4748 0x9c8b 0x43f 0x409 0x4943 0x9c2d 0x454 0x41d 0x4b3e 0x9bd0 0x465 0x42c 0x4d39 0x9b6e 0x477 0x43e 0x4f33 0x9b03 0x47d 0x444 0x512e 0x9a8d 0x47f 0x446 0x5329 0x99e9 0x428 0x3f3 0x5524 0x995a 0x3f1 0x3bf 0x571f 0x98ed 0x3e7 0x3b5 0x591a 0x9893 0x3e4 0x3b2 0x5b15 0x9842 0x3e1 0x3b0 0x5d10 0x97f8 0x3e0 0x3af 0x5f0b 0x97b3 0x3df 0x3ae 0x6105 0x9773 0x3e0 0x3ae 0x6300 0x9734 0x3e1 0x3b0 0x64fb 0x96f9 0x3e1 0x3b0 0x66f6 0x96bf 0x3e1 0x3b0 0x68f1 0x9686 0x3dc 0x3aa 0x6aec 0x9655 0x3e4 0x3b2 0x6ce7 0x9621 0x3e8 0x3b6 0x6ee2 0x95ee 0x3e7 0x3b5 0x70dc 0x95be 0x3ea 0x3b7 0x72d7 0x9592 0x3ef 0x3bc 0x74d2 0x9565 0x3ee 0x3bc 0x76cd 0x953b 0x3ef 0x3bc 0x78c8 0x9515 0x3fc 0x3c9 0x7ac3 0x94ee 0x408 0x3d5 0x7cbe 0x94c9 0x409 0x3d6 0x7eb9 0x94a4 0x40e 0x3da 0x80b4 0x9482 0x41e 0x3ea 0x82ae 0x945b 0x421 0x3ed 0x84a9 0x9434 0x427 0x3f2 0x86a4 0x9404 0x425 0x3f0 0x889f 0x93bb 0x3fd 0x3ca 0x8a9a 0x9364 0x3d8 0x3a7 0x8c95 0x9320 0x3d9 0x3a8 0x8e90 0x92ed 0x3e5 0x3b3 0x908b 0x92b8 0x3e0 0x3ae 0x9286 0x9288 0x3e6 0x3b4 0x9480 0x9257 0x3e8 0x3b6 0x967b 0x9228 0x3ec 0x3ba 0x9876 0x91fc 0x3ef 0x3bc 0x9a71 0x91d4 0x3f4 0x3c1 0x9c6c 0x91a8 0x3fe 0x3cb 0x9e67 0x916f 0x3ff 0x3cc 0xa062 0x912a 0x3ee 0x3bc 0xa25d 0x90e6 0x3ec 0x3ba 0xa458 0x90a9 0x3fa 0x3c7 0xa652 0x905f 0x3fa 0x3c7 0xa84d 0x9012 0x3da 0x3a8 0xaa48 0x8fea 0x3cf 0x39e 0xac43 0x8fdd 0x3e3 0x3b2 0xae3e 0x8fd2 0x400 0x3cd 0xb039 0x8fc3 0x422 0x3ee 0xb234 0x8fae 0x45f 0x427 0xb42f 0x8f7d 0x498 0x45d 0xb629 0x8ed7 0x44e 0x417 0xb824 0x8d3d 0x424 0x3ef 0xba1f 0x8b15 0x440 0x409 0xbc1a 0x882d 0x479 0x43f 0xbe15 0x83d8 0x525 0x4e3 0xc010 0x81bb 0x20eb 0x1f46 0xc20b 0x81ba 0x35ea 0x3338 0xc406 0x81ba 0x35ea 0x3338>;
			battery2_profile_t0_col = <0x4>;
			battery2_profile_t0_num = <0x64>;
			battery2_profile_t1 = <0x0 0xac7f 0x488 0x44e 0x1fb 0xac1a 0x486 0x44c 0x3f6 0xabb6 0x486 0x44c 0x5f1 0xab59 0x48f 0x455 0x7ec 0xaaf8 0x493 0x459 0x9e6 0xaa94 0x48c 0x452 0xbe1 0xaa2c 0x486 0x44c 0xddc 0xa9c4 0x48a 0x450 0xfd7 0xa95d 0x493 0x459 0x11d2 0xa8ed 0x493 0x459 0x13cd 0xa87d 0x493 0x458 0x15c8 0xa807 0x485 0x44b 0x17c3 0xa792 0x485 0x44c 0x19be 0xa718 0x486 0x44c 0x1bb8 0xa6a1 0x48e 0x454 0x1db3 0xa62b 0x49a 0x45f 0x1fae 0xa5b3 0x4a0 0x465 0x21a9 0xa538 0x4a1 0x466 0x23a4 0xa4bd 0x4a2 0x467 0x259f 0xa443 0x4a0 0x465 0x279a 0xa3cd 0x4a0 0x465 0x2995 0xa353 0x494 0x459 0x2b8f 0xa2dc 0x49e 0x463 0x2d8a 0xa267 0x4a0 0x465 0x2f85 0xa1f5 0x4b2 0x476 0x3180 0xa185 0x4c4 0x487 0x337b 0xa113 0x4c5 0x488 0x3576 0xa0a0 0x4b9 0x47c 0x3771 0xa030 0x4b0 0x474 0x396c 0x9fc2 0x4b4 0x478 0x3b67 0x9f5d 0x4cc 0x48e 0x3d61 0x9ef3 0x4da 0x49c 0x3f5c 0x9e89 0x4d8 0x49a 0x4157 0x9e23 0x4d8 0x49a 0x4352 0x9dc2 0x4eb 0x4ac 0x454d 0x9d60 0x4fd 0x4bd 0x4748 0x9cfe 0x509 0x4c8 0x4943 0x9ca1 0x51a 0x4d8 0x4b3e 0x9c45 0x52e 0x4ec 0x4d39 0x9be8 0x53d 0x4fa 0x4f33 0x9b8d 0x554 0x510 0x512e 0x9b22 0x554 0x510 0x5329 0x9a9c 0x523 0x4e1 0x5524 0x99ef 0x4ba 0x47e 0x571f 0x995f 0x485 0x44b 0x591a 0x98ee 0x477 0x43e 0x5b15 0x9893 0x476 0x43d 0x5d10 0x9842 0x46c 0x434 0x5f0b 0x97f9 0x465 0x42d 0x6105 0x97b9 0x471 0x438 0x6300 0x9772 0x45f 0x427 0x64fb 0x973a 0x478 0x43f 0x66f6 0x96fd 0x46c 0x434 0x68f1 0x96c5 0x46b 0x433 0x6aec 0x9691 0x475 0x43c 0x6ce7 0x965b 0x478 0x43f 0x6ee2 0x9626 0x478 0x43f 0x70dc 0x95f6 0x47d 0x444 0x72d7 0x95c7 0x484 0x44a 0x74d2 0x9598 0x48c 0x452 0x76cd 0x9570 0x4a2 0x467 0x78c8 0x9549 0x4b0 0x474 0x7ac3 0x951c 0x4ae 0x472 0x7cbe 0x94fa 0x4c6 0x489 0x7eb9 0x94d9 0x4cb 0x48d 0x80b4 0x94b7 0x4cb 0x48d 0x82ae 0x9492 0x4cb 0x48d 0x84a9 0x9470 0x4d6 0x499 0x86a4 0x9452 0x4e5 0x4a7 0x889f 0x942e 0x4df 0x4a0 0x8a9a 0x9400 0x4c7 0x48a 0x8c95 0x93ce 0x4af 0x473 0x8e90 0x9396 0x4a3 0x468 0x908b 0x9363 0x48a 0x450 0x9286 0x933a 0x49a 0x45f 0x9480 0x930b 0x4a2 0x467 0x967b 0x92d9 0x49a 0x45f 0x9876 0x92ac 0x49f 0x464 0x9a71 0x9286 0x4ae 0x472 0x9c6c 0x9265 0x4b2 0x476 0x9e67 0x923f 0x4bb 0x47f 0xa062 0x9207 0x4b0 0x474 0xa25d 0x91ca 0x4b0 0x474 0xa458 0x9186 0x4a2 0x467 0xa652 0x9151 0x4c0 0x483 0xa84d 0x910e 0x4c1 0x484 0xaa48 0x90bb 0x4b6 0x479 0xac43 0x907a 0x4a8 0x46d 0xae3e 0x9059 0x4a0 0x465 0xb039 0x904a 0x4a9 0x46d 0xb234 0x903d 0x4bf 0x483 0xb42f 0x902c 0x4cd 0x48f 0xb629 0x9016 0x4f5 0x4b5 0xb824 0x8fde 0x533 0x4f0 0xba1f 0x8ee5 0x4f6 0x4b7 0xbc1a 0x8d2d 0x4f8 0x4b8 0xbe15 0x8aca 0x51a 0x4d8 0xc010 0x8778 0x563 0x51e 0xc20b 0x81bb 0x70e 0x6b4 0xc406 0x7c7e 0x2a4f 0x2832>;
			battery2_profile_t1_col = <0x4>;
			battery2_profile_t1_num = <0x64>;
			battery2_profile_t2 = <0x0 0xacb0 0x780 0x6a4 0x1fb 0xac3a 0x77c 0x6a4 0x3f6 0xabd7 0x793 0x6a4 0x5f1 0xab77 0x797 0x6a4 0x7ec 0xab12 0x77c 0x6a4 0x9e6 0xaab0 0x776 0x6a4 0xbe1 0xaa49 0x774 0x6a4 0xddc 0xa9dd 0x768 0x6a4 0xfd7 0xa970 0x75d 0x6a4 0x11d2 0xa900 0x75a 0x6a4 0x13cd 0xa892 0x76c 0x6a4 0x15c8 0xa81a 0x760 0x6a4 0x17c3 0xa79d 0x752 0x6a4 0x19be 0xa726 0x745 0x6a4 0x1bb8 0xa6a4 0x737 0x6a4 0x1db3 0xa627 0x736 0x6a4 0x1fae 0xa5aa 0x737 0x6a4 0x21a9 0xa52d 0x737 0x6a4 0x23a4 0xa4b3 0x73d 0x6a4 0x259f 0xa43a 0x744 0x6a4 0x279a 0xa3bf 0x748 0x6a4 0x2995 0xa346 0x74c 0x6a4 0x2b8f 0xa2ca 0x73a 0x6ae 0x2d8a 0xa253 0x752 0x6f4 0x2f85 0xa1dc 0x760 0x702 0x3180 0xa164 0x75f 0x701 0x337b 0xa0f7 0x776 0x716 0x3576 0xa082 0x771 0x711 0x3771 0xa00f 0x776 0x716 0x396c 0x9fa1 0x77c 0x71c 0x3b67 0x9f35 0x789 0x728 0x3d61 0x9ecb 0x7a7 0x745 0x3f5c 0x9e63 0x7c4 0x761 0x4157 0x9df7 0x7d3 0x76f 0x4352 0x9d8b 0x7ea 0x785 0x454d 0x9d20 0x7f8 0x792 0x4748 0x9cbf 0x805 0x79e 0x4943 0x9c59 0x7ee 0x789 0x4b3e 0x9bf8 0x7e9 0x784 0x4d39 0x9b93 0x7ea 0x785 0x4f33 0x9b1d 0x7d1 0x76c 0x512e 0x9a96 0x793 0x732 0x5329 0x9a00 0x73b 0x6de 0x5524 0x996c 0x6e1 0x689 0x571f 0x98f2 0x6a5 0x650 0x591a 0x988e 0x690 0x63c 0x5b15 0x9836 0x68f 0x63b 0x5d10 0x97ec 0x684 0x631 0x5f0b 0x979c 0x676 0x623 0x6105 0x975d 0x675 0x623 0x6300 0x971e 0x680 0x62d 0x64fb 0x96df 0x683 0x62f 0x66f6 0x96a1 0x672 0x620 0x68f1 0x9669 0x676 0x624 0x6aec 0x9636 0x683 0x62f 0x6ce7 0x9600 0x683 0x62f 0x6ee2 0x95cb 0x683 0x62f 0x70dc 0x959e 0x685 0x632 0x72d7 0x9570 0x690 0x63c 0x74d2 0x9543 0x693 0x63f 0x76cd 0x951b 0x69f 0x64a 0x78c8 0x94f4 0x6a0 0x64b 0x7ac3 0x94cb 0x69e 0x649 0x7cbe 0x94a4 0x6a8 0x653 0x7eb9 0x9480 0x6ad 0x657 0x80b4 0x9461 0x6ad 0x657 0x82ae 0x9445 0x6c0 0x66a 0x84a9 0x9424 0x6d1 0x67a 0x86a4 0x93ff 0x6c8 0x671 0x889f 0x93e2 0x6c5 0x66e 0x8a9a 0x93c0 0x6ba 0x664 0x8c95 0x93a3 0x6ba 0x664 0x8e90 0x9376 0x6ae 0x658 0x908b 0x9349 0x696 0x641 0x9286 0x9316 0x67c 0x629 0x9480 0x92e3 0x675 0x623 0x967b 0x92bb 0x67e 0x62a 0x9876 0x9296 0x684 0x630 0x9a71 0x926c 0x684 0x630 0x9c6c 0x923c 0x68c 0x639 0x9e67 0x9203 0x69e 0x649 0xa062 0x91bf 0x6a2 0x64d 0xa25d 0x917d 0x6ae 0x659 0xa458 0x9149 0x6ca 0x673 0xa652 0x90f4 0x6ca 0x673 0xa84d 0x9094 0x6bc 0x666 0xaa48 0x9068 0x6c5 0x66e 0xac43 0x9053 0x6da 0x682 0xae3e 0x9042 0x70e 0x6b3 0xb039 0x902e 0x73e 0x6e2 0xb234 0x9014 0x76a 0x70b 0xb42f 0x8fe1 0x7a2 0x740 0xb629 0x8f43 0x7d2 0x76e 0xb824 0x8dce 0x7ea 0x785 0xba1f 0x8b88 0x833 0x7ca 0xbc1a 0x8881 0x8d0 0x85f 0xbe15 0x83c8 0x9fd 0x97d 0xc010 0x837c 0x3742 0x347e 0xc20b 0x837c 0x39d9 0x36f4 0xc406 0x837c 0x39d9 0x36f4>;
			battery2_profile_t2_col = <0x4>;
			battery2_profile_t2_num = <0x64>;
			battery2_profile_t3 = <0x0 0xac22 0xb5e 0x9c4 0x1fb 0xab9c 0xb5b 0x9c4 0x3f6 0xab2e 0xb7d 0x9c4 0x5f1 0xaacd 0xb85 0x9c4 0x7ec 0xaa66 0xb75 0x9c4 0x9e6 0xa9ff 0xb62 0x9c4 0xbe1 0xa997 0xb55 0x9c4 0xddc 0xa92d 0xb49 0x9c4 0xfd7 0xa8c2 0xb3a 0x9c4 0x11d2 0xa852 0xb24 0x9c4 0x13cd 0xa7e2 0xb18 0x9c4 0x15c8 0xa76c 0xb0a 0x9c4 0x17c3 0xa6f2 0xaf2 0x9c4 0x19be 0xa677 0xada 0x9c4 0x1bb8 0xa600 0xac9 0x9c4 0x1db3 0xa587 0xabd 0x9c4 0x1fae 0xa50c 0xab0 0x9ec 0x21a9 0xa493 0xaa8 0xa20 0x23a4 0xa41c 0xaa4 0xa1b 0x259f 0xa3a2 0xa9b 0xa14 0x279a 0xa32d 0xaa9 0xa20 0x2995 0xa2b8 0xaa9 0xa20 0x2b8f 0xa23d 0xa91 0xa09 0x2d8a 0xa1c6 0xa98 0xa10 0x2f85 0xa155 0xa9c 0xa14 0x3180 0xa0e2 0xa9c 0xa14 0x337b 0xa06f 0xaa2 0xa19 0x3576 0x9fff 0xaa9 0xa20 0x3771 0x9f91 0xaa9 0xa20 0x396c 0x9f27 0xaad 0xa24 0x3b67 0x9ebc 0xac6 0xa3c 0x3d61 0x9e57 0xaea 0xa5e 0x3f5c 0x9de8 0xaf7 0xa6b 0x4157 0x9d78 0xb05 0xa78 0x4352 0x9d08 0xafe 0xa71 0x454d 0x9c9d 0xafa 0xa6e 0x4748 0x9c30 0xaef 0xa63 0x4943 0x9bc2 0xad6 0xa4b 0x4b3e 0x9b56 0xab9 0xa2f 0x4d39 0x9ae6 0xa96 0xa0f 0x4f33 0x9a75 0xa79 0x9f3 0x512e 0x99f4 0xa3b 0x9b8 0x5329 0x996e 0x9e4 0x965 0x5524 0x98f6 0x9b9 0x93c 0x571f 0x9889 0x98a 0x910 0x591a 0x9826 0x969 0x8f0 0x5b15 0x97ce 0x957 0x8e0 0x5d10 0x977c 0x94a 0x8d3 0x5f0b 0x9733 0x945 0x8cf 0x6105 0x96f5 0x950 0x8d9 0x6300 0x96b3 0x952 0x8da 0x64fb 0x967b 0x95e 0x8e6 0x66f6 0x9638 0x952 0x8db 0x68f1 0x95fe 0x950 0x8d9 0x6aec 0x95cb 0x95a 0x8e2 0x6ce7 0x9599 0x95e 0x8e6 0x6ee2 0x9567 0x965 0x8ec 0x70dc 0x9537 0x971 0x8f8 0x72d7 0x950a 0x97d 0x904 0x74d2 0x94df 0x988 0x90e 0x76cd 0x94b6 0x988 0x90e 0x78c8 0x948a 0x995 0x91b 0x7ac3 0x9463 0x995 0x91b 0x7cbe 0x9441 0x9a0 0x925 0x7eb9 0x9424 0x9b6 0x93a 0x80b4 0x9400 0x9bf 0x942 0x82ae 0x93e0 0x9c0 0x943 0x84a9 0x93c4 0x9cb 0x94e 0x86a4 0x93a6 0x9d1 0x953 0x889f 0x9386 0x9c1 0x944 0x8a9a 0x9371 0x9cf 0x951 0x8c95 0x9360 0x9dc 0x95e 0x8e90 0x934f 0xa0c 0x98c 0x908b 0x9334 0xa10 0x98f 0x9286 0x930f 0xa11 0x990 0x9480 0x92ec 0xa23 0x9a1 0x967b 0x92c1 0xa25 0x9a3 0x9876 0x9291 0xa31 0x9ae 0x9a71 0x9266 0xa5a 0x9d6 0x9c6c 0x923b 0xa89 0xa02 0x9e67 0x9202 0xab5 0xa2c 0xa062 0x91c4 0xafe 0xa71 0xa25d 0x917b 0xb30 0xaa1 0xa458 0x9138 0xb6e 0xadb 0xa652 0x90f4 0xbd4 0xb3d 0xa84d 0x909d 0xc21 0xb85 0xaa48 0x9048 0xc76 0xbd7 0xac43 0x900e 0xce6 0xc41 0xae3e 0x8fec 0xd76 0xcca 0xb039 0x8fd0 0xe30 0xd7a 0xb234 0x8fb3 0xf0d 0xe4c 0xb42f 0x8f8e 0x1018 0xf4a 0xb629 0x8f51 0x1181 0x10a1 0xb824 0x8ebd 0x1362 0x126a 0xba1f 0x8d3e 0x159d 0x1489 0xbc1a 0x8af6 0x19c3 0x1879 0xbe15 0x87c4 0x2402 0x2235 0xc010 0x861a 0x3c9b 0x3993 0xc20b 0x861a 0x3faa 0x3c7b 0xc406 0x861a 0x3faa 0x3c7b>;
			battery2_profile_t3_col = <0x4>;
			battery2_profile_t3_num = <0x64>;
			battery2_profile_t4 = <0x0 0xac8b 0x1432 0x122d 0x1fb 0xabe9 0x142f 0x122a 0x3f6 0xab60 0x1446 0x123f 0x5f1 0xaae2 0x144a 0x1243 0x7ec 0xaa6f 0x1441 0x123b 0x9e6 0xa9fc 0x142e 0x122a 0xbe1 0xa989 0x1421 0x121e 0xddc 0xa917 0x13ee 0x11f0 0xfd7 0xa8a2 0x1394 0x119f 0x11d2 0xa82d 0x13e8 0x11ea 0x13cd 0xa7bd 0x13da 0x11de 0x15c8 0xa759 0x13dc 0x11e0 0x17c3 0xa6f9 0x1060 0xebd 0x19be 0xa67b 0x11d3 0x100b 0x1bb8 0xa5fd 0x12b7 0x10d7 0x1db3 0xa585 0x12b5 0x10d6 0x1fae 0xa50d 0x12a3 0x10c6 0x21a9 0xa494 0x128e 0x10b3 0x23a4 0xa41d 0x127e 0x10a5 0x259f 0xa3a3 0x1264 0x108d 0x279a 0xa32e 0x123f 0x106c 0x2995 0xa2b9 0x123f 0x106c 0x2b8f 0xa249 0x1257 0x1082 0x2d8a 0xa1cf 0x1251 0x107c 0x2f85 0xa158 0x1244 0x1070 0x3180 0xa0e6 0x123f 0x106c 0x337b 0xa076 0x1245 0x1071 0x3576 0xa007 0x1251 0x107c 0x3771 0x9f98 0x1261 0x108a 0x396c 0x9f2d 0x127b 0x10a1 0x3b67 0x9ebd 0x1293 0x10b8 0x3d61 0x9e4d 0x12b9 0x10da 0x3f5c 0x9dd4 0x12c7 0x10e6 0x4157 0x9d58 0x12c9 0x10e8 0x4352 0x9cde 0x11e0 0x1017 0x454d 0x9c6d 0x124e 0x107a 0x4748 0x9bf5 0x1240 0x106c 0x4943 0x9b6e 0x11d8 0x1010 0x4b3e 0x9aed 0x12e7 0x1103 0x4d39 0x9a79 0x12eb 0x1106 0x4f33 0x9a09 0x12c7 0x10e6 0x512e 0x9999 0x12ad 0x10cf 0x5329 0x9924 0x12ae 0x10d0 0x5524 0x98c7 0xe0b 0xca3 0x571f 0x985d 0x10b4 0xf08 0x591a 0x97f4 0x12f7 0x1112 0x5b15 0x9798 0x1321 0x1138 0x5d10 0x9746 0x132d 0x1142 0x5f0b 0x96f8 0x133a 0x114e 0x6105 0x96ab 0x134a 0x115c 0x6300 0x9664 0x1364 0x1174 0x64fb 0x962c 0x1396 0x11a1 0x66f6 0x95e9 0x13b1 0x11b9 0x68f1 0x95b0 0x13d3 0x11d8 0x6aec 0x9578 0x13f9 0x11fa 0x6ce7 0x9544 0x140e 0x120d 0x6ee2 0x9511 0x1427 0x1223 0x70dc 0x94e1 0x144c 0x1244 0x72d7 0x94b6 0x1472 0x1267 0x74d2 0x948e 0x1498 0x1289 0x76cd 0x9462 0x14bd 0x12aa 0x78c8 0x9441 0x14ef 0x12d7 0x7ac3 0x9425 0x1513 0x12f8 0x7cbe 0x9404 0x152f 0x1310 0x7eb9 0x93eb 0x1550 0x132f 0x80b4 0x93d4 0x158d 0x1366 0x82ae 0x93c1 0x15cb 0x139e 0x84a9 0x93b1 0x160e 0x13da 0x86a4 0x939e 0x165d 0x1420 0x889f 0x9387 0x16a3 0x1460 0x8a9a 0x9372 0x1706 0x14b8 0x8c95 0x935b 0x175c 0x1506 0x8e90 0x934f 0x179a 0x153e 0x908b 0x9330 0x1753 0x14fe 0x9286 0x930b 0x1802 0x159b 0x9480 0x92e8 0x18b8 0x163f 0x967b 0x92c0 0x1945 0x16be 0x9876 0x9293 0x19d3 0x173e 0x9a71 0x9264 0x1a74 0x17cf 0x9c6c 0x922f 0x1b2e 0x1876 0x9e67 0x91f1 0x1be9 0x191e 0xa062 0x91ae 0x1ca5 0x19c8 0xa25d 0x9165 0x1d84 0x1a90 0xa458 0x911d 0x1e64 0x1b5a 0xa652 0x90d0 0x1f88 0x1c61 0xa84d 0x9082 0x20ad 0x1d68 0xaa48 0x9030 0x21d8 0x1e76 0xac43 0x8fe7 0x232c 0x1fa7 0xae3e 0x8faf 0x24cd 0x211f 0xb039 0x8f82 0x26ce 0x22ed 0xb234 0x8f57 0x2923 0x2506 0xb42f 0x8f2f 0x2c1e 0x27b4 0xb629 0x8ef7 0x300b 0x2b3e 0xb824 0x8e8c 0x35aa 0x304c 0xba1f 0x8d99 0x3e54 0x3818 0xbc1a 0x8d49 0x4d93 0x45d1 0xbe15 0x8d4a 0x4fa3 0x47ac 0xc010 0x8d4a 0x4fa3 0x47ac 0xc20b 0x8d4a 0x4fa3 0x47ac 0xc406 0x8d4a 0x4fa3 0x47ac>;
			battery2_profile_t4_col = <0x4>;
			battery2_profile_t4_num = <0x64>;
			g_FG_PSEUDO100 = <0x61 0x61 0x64 0x64 0x60 0x60 0x64 0x64 0x5d 0x5e 0x64 0x64 0x5c 0x5c 0x64 0x64 0x5c 0x5c 0x64 0x64 0x64 0x64 0x64 0x64 0x64 0x64 0x64 0x64 0x64 0x64 0x64 0x64 0x64 0x64 0x64 0x64 0x64 0x64 0x64 0x64>;
			g_FG_PSEUDO100_col = <0xa>;
			g_FG_PSEUDO100_row = <0x4>;
			g_PMIC_MIN_VOL = <0x82dc 0x82dc 0x82dc 0x82dc 0x82dc 0x82dc 0x82dc 0x82dc 0x86c4 0x85fc 0x82dc 0x82dc 0x88b8 0x87f0 0x7dc8 0x7dc8 0x88b8 0x84d0 0x7918 0x7918 0x7918 0x7918 0x7918 0x7918 0x7918 0x7918 0x7918 0x7918 0x7918 0x7918 0x7918 0x7918 0x7918 0x7918 0x7918 0x7918 0x7918 0x7918 0x7918 0x79e0>;
			g_PMIC_MIN_VOL_col = <0xa>;
			g_PMIC_MIN_VOL_row = <0x4>;
			g_PON_SYS_IBOOT = <0x1388 0x1388 0x1388 0x1388 0x1388 0x1388 0x1388 0x1388 0x1388 0x1388 0x1388 0x1388 0x1388 0x1388 0x1388 0x1388 0x1388 0x1388 0x1388 0x1388 0x1388 0x1388 0x1388 0x1388 0x1388 0x1388 0x1388 0x1388 0x1388 0x1388 0x1388 0x1388 0x1388 0x1388 0x1388 0x1388 0x1388 0x1388 0x1388 0x1388>;
			g_PON_SYS_IBOOT_col = <0xa>;
			g_PON_SYS_IBOOT_row = <0x4>;
			g_QMAX_SYS_VOL = <0x82dc 0x8340 0x82dc 0x82dc 0x82dc 0x8340 0x82dc 0x82dc 0x8aac 0x87f0 0x82dc 0x82dc 0x8aac 0x89e4 0x8084 0x8084 0x88b8 0x86c4 0x8020 0x8020 0x8020 0x8020 0x8020 0x8020 0x8020 0x8020 0x8020 0x8020 0x8020 0x8020 0x8020 0x8020 0x8020 0x8020 0x8020 0x8020 0x8020 0x8020 0x8020 0x8020>;
			g_QMAX_SYS_VOL_col = <0xa>;
			g_QMAX_SYS_VOL_row = <0x4>;
			io-channel-names = "auxadc6-batt_id_v";
			io-channels = <0xffffffff 0x6>;
		};
	};

	fragment@9 {
		target = <0xffffffff>;

		__overlay__ {

			dischg_disable {
				phandle = <0x3>;

				pins_cmd_dat {
					bias-pull-down = <0x0>;
					output-low;
					pinmux = <0x8600>;
					slew-rate = <0x1>;
				};
			};

			dischg_enable {
				phandle = <0x2>;

				pins_cmd_dat {
					bias-pull-up = <0x0>;
					output-high;
					pinmux = <0x8600>;
					slew-rate = <0x1>;
				};
			};

			eint0default {
				phandle = <0x1>;
			};
		};
	};
};
